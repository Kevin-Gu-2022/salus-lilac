## CMakeLists.txt
```
# SPDX-License-Identifier: Apache-2.0
cmake_minimum_required(VERSION 3.20.0)
find_package(Zephyr REQUIRED HINTS $ENV{ZEPHYR_BASE})
project(base_node)

FILE(GLOB app_sources src/*.c)

FILE(GLOB lib_sources lib/*.c)

target_sources(app PRIVATE ${app_sources} ${lib_sources})

target_include_directories(app PRIVATE include)
```

## sysbuild.conf
```
# Sysbuild configuration file.
SB_CONFIG_BOOTLOADER_MCUBOOT=y
```

## prj.conf
```kconfig
CONFIG_SHELL=y
CONFIG_HEAP_MEM_POOL_SIZE=2048
CONFIG_NEWLIB_LIBC=y
CONFIG_NEWLIB_LIBC_FLOAT_PRINTF=y
CONFIG_CBPRINTF_COMPLETE=y
CONFIG_CBPRINTF_FP_SUPPORT=y

# Bluetooth configuration
CONFIG_BT=y
CONFIG_BT_PRIVACY=n
CONFIG_BT_ID_MAX=1
CONFIG_BT_CENTRAL=y
CONFIG_BT_GATT_CLIENT=y

# Flash
CONFIG_FLASH=y 
CONFIG_FLASH_MAP=y

# LittleFS configuration
CONFIG_FILE_SYSTEM=y
CONFIG_FILE_SYSTEM_SHELL=y
CONFIG_FILE_SYSTEM_LITTLEFS=y
CONFIG_MAIN_STACK_SIZE=4096
CONFIG_HEAP_MEM_POOL_SIZE=16384

# Logging configuration
CONFIG_JSON_LIBRARY=y
CONFIG_USE_SEGGER_RTT=y
CONFIG_SHELL_BACKEND_RTT=y
CONFIG_LOG=y

CONFIG_PWM=y
CONFIG_GPIO=y

# Blockchain configuration
CONFIG_NEWLIB_LIBC=y
CONFIG_MBEDTLS=y
CONFIG_MBEDTLS_BUILTIN=y
```

## boards/disco_l475_iot1.overlay
```dts
/ {
    servo: servo {
        compatible = "pwm-servo";
        pwms = <&pwm2 1 PWM_MSEC(20) PWM_POLARITY_NORMAL>; // TIM2_CH1 = channel 1
        min-pulse = <PWM_USEC(700)>;
        max-pulse = <PWM_USEC(2300)>;
    };
};
```

## boards/nrf52840dk_nrf52840.overlay
```dts
&pwm0 {
    status = "okay";
};

&gpio0 {
    status = "okay";
};

 / {
    servo: servo {
        compatible = "pwm-servo";
        pwms = <&pwm0 0 PWM_MSEC(20) PWM_POLARITY_NORMAL>; // channel 0 (P0.13)
        min-pulse = <PWM_USEC(700)>;
        max-pulse = <PWM_USEC(2300)>;
    };
};
```

## src/main.c
```c
/*
* @file     main.c
* @brief    Smart Entry System Project - Base Node
* @author   Lachlan Chun, 47484874
*/

#include <zephyr/kernel.h>
#include <zephyr/device.h>
#include <zephyr/sys/printk.h>
#include <zephyr/sys/util.h>
#include <zephyr/shell/shell.h>
#include <stdlib.h>
#include "SEGGER_RTT.h"
#include "user.h"
#include "fs.h"
#include "event.h"
#include "servo.h"
#include "keypad.h"
#include "sensor.h"

// Adding users command.
static int cmd_user_add(const struct shell *shell, size_t argc, char **argv) {
    const char *alias = NULL;
    const char *mac = NULL;
    const char *passcode = NULL;

    for (int i = 1; i < argc - 1; i++) {
        if (strcmp(argv[i], "-a") == 0) {
            alias = argv[i + 1];
        } else if (strcmp(argv[i], "-m") == 0) {
            mac = argv[i + 1];
        } else if (strcmp(argv[i], "-p") == 0) {
            passcode = argv[i + 1];
        }
    }

    if (!alias || !mac || !passcode) {
        shell_print(shell, "Usage: user add -a <alias> -m <MAC> -p <passcode>");
        return -EINVAL;
    }

    int ret = user_add(alias, mac, passcode);
    switch (ret) {
        case USER_SUCCESS:
            shell_print(shell, "Entry access for user '%s' has been granted.", alias);
            break;
        case USER_ALREADY_EXISTS:
            shell_print(shell, "User '%s' already has entry access permissions.", alias);
            break;
        case USER_MAC_ALREADY_EXISTS:
            shell_print(shell, "MAC Address '%s' is already in use.", mac);
            break;
        case USER_MAC_INVALID:
            shell_print(shell, "MAC Address '%s' is not valid.", mac);
            break;
        case USER_PASSCODE_INVALID:
            shell_print(shell, "Passcode is not valid.");
            break;
        case USER_MEMORY_ERROR:
            shell_print(shell, "Memory allocation failed.");
            break;
        default:
            shell_print(shell, "Unknown error.");
            break;
    }

    return 0;
}

// Removing users command.
static int cmd_user_remove(const struct shell *shell, size_t argc, char **argv) {
    if (argc != 2) {
        shell_print(shell, "Usage: user remove <alias>");
        return -EINVAL;
    }

    int ret = user_remove(argv[1]);
    if (ret == USER_SUCCESS) {
        shell_print(shell, "Entry access for user '%s' has been revoked.", argv[1]);
    } else {
        shell_print(shell, "User '%s' not found in the list.", argv[1]);
    }

    return 0;
}

// Viewing users command.
static int cmd_user_view(const struct shell *shell, size_t argc, char **argv) {
    if (argc != 2) {
        shell_print(shell, "Usage: user view <alias | -a>");
        return -EINVAL;
    }

    user_view(shell, argv[1]);
    return 0;
}

static int cmd_sensor_ultrasonic(const struct shell *shell, size_t argc, char **argv) {
    if (argc < 2) {
        shell_error(shell, "Missing value. Usage: sensor u <value>");
        return -EINVAL;
    }
    double val = strtod(argv[1], NULL);
    sensor_set_ultrasonic_threshold(val);
    shell_print(shell, "Ultrasonic threshold set to %.3f", val);
    return 0;
}

static int cmd_sensor_magnetometer(const struct shell *shell, size_t argc, char **argv) {
    if (argc < 2) {
        shell_error(shell, "Missing value. Usage: sensor m <value>");
        return -EINVAL;
    }
    double val = strtod(argv[1], NULL);
    sensor_set_magnetometer_threshold(val);
    shell_print(shell, "Magnetometer threshold set to %.3f", val);
    return 0;
}

static int cmd_sensor_view(const struct shell *shell, size_t argc, char **argv) {
    const sensor_threshold_t *t = sensor_get_thresholds();
    shell_print(shell, "{Magnetometer Threshold: %s}", t->mag_threshold);
    shell_print(shell, "{Ultrasonic Threshold: %s}", t->ultra_threshold);
    return 0;
}

// Main.
int main(void) {
    user_init();
    sensor_threshold_init();
    fs_init();
    SEGGER_RTT_Init();
    servo_init();
    keypad_init();
    bluetooth_init();
}

// Subcommands for user and sensor configuration.
SHELL_STATIC_SUBCMD_SET_CREATE(
    user_cmds,
    SHELL_CMD(add, NULL, "Add a user: -a <alias> -m <MAC address> -p <passcode>", cmd_user_add),
    SHELL_CMD(remove, NULL, "Remove user: user remove <alias>", cmd_user_remove),
    SHELL_CMD(view, NULL, "View user/s: user view <alias> or user view -a", cmd_user_view),
    SHELL_SUBCMD_SET_END
);

SHELL_STATIC_SUBCMD_SET_CREATE(
    sensor_cmds,
    SHELL_CMD(u, NULL, "Set ultrasonic threshold: sensor u <value>", cmd_sensor_ultrasonic),
    SHELL_CMD(m, NULL, "Set magnetometer threshold: sensor m <value>", cmd_sensor_magnetometer),
    SHELL_CMD(view, NULL, "View current sensor thresholds", cmd_sensor_view),
    SHELL_SUBCMD_SET_END
);

SHELL_CMD_REGISTER(user, &user_cmds, "User entry access configuration commands.", NULL);
SHELL_CMD_REGISTER(sensor, &sensor_cmds, "Sensor threshold configuration commands.", NULL);
```

## include/blockchain.h
```c
#ifndef BLOCKCHAIN_H
#define BLOCKCHAIN_H

#define MAX_BLOCKS 50
#define HASH_SIZE 65

#define BLOCKCHAIN_FILE "/lfs/chain.log"

typedef struct {
    char timestamp[32];
    char event[32];
    char mag_meas[10];
    char ultra_meas[10];
    char user[32];
    char MAC[18];
    char prev_hash[HASH_SIZE];
    char curr_hash[HASH_SIZE];
} Block;

/* Add block to blockchain */
void add_block(const char *timestamp, const char *event, const char *user, const char *mag_meas, const char *ultra_meas, const char *mac);
/* Validate blockchain from file system */
bool validate_chain_from_file(void);
/* Validate blockchain held in RAM */
bool validate_chain_in_RAM(void);
/* Print contents of blockchain */
void print_chain(void);


#endif /* BLOCKCHAIN_H */
```

## include/bluetooth.h
```c
/*
* @file     bluetooth.h
* @brief    Bluetooth Library
* @author   Xinlin Zhong, 48018061
*/

#ifndef BLUETOOTH_H
#define BLUETOOTH_H

#include <zephyr/device.h>
#include <zephyr/devicetree.h>
#include <stdio.h>
#include <string.h>
#include <zephyr/kernel.h>
#include <zephyr/bluetooth/bluetooth.h>
#include <zephyr/bluetooth/services/nus.h>
#include <zephyr/sys/slist.h>
#include <stdbool.h>
#include <string.h>
#include "user.h"

#define STACKSIZE           4096
#define DEVICE_NAME		    CONFIG_BT_DEVICE_NAME
#define DEVICE_NAME_LEN		(sizeof(DEVICE_NAME) - 1)
#define MSGQ_SIZE           10

extern struct k_msgq user_mac_msgq;
extern struct k_msgq user_passcode_msgq;
extern struct k_sem user_disconnect_sem;

extern int bluetooth_init(void);
extern int bluetooth_advertise(void);
extern void bluetooth_write(const char *msg, size_t len);

#endif
```

## include/event.h
```c
/*
* @file     event.h
* @brief    Event Detection and Classification
* @author   Lachlan Chun, 47484874
*/

#ifndef EVENT_H
#define EVENT_H

#include <zephyr/device.h>
#include <zephyr/devicetree.h>
#include <zephyr/kernel.h>
#include <zephyr/logging/log.h>
#include <zephyr/bluetooth/bluetooth.h>
#include <zephyr/bluetooth/conn.h>
#include <zephyr/bluetooth/gatt.h>
#include <zephyr/bluetooth/uuid.h>
#include <zephyr/bluetooth/hci.h>
#include <zephyr/sys/printk.h>
#include <zephyr/sys/byteorder.h>
#include <zephyr/sys/slist.h>
#include <stdio.h>
#include <stdbool.h>
#include <string.h>
#include "user.h"
#include "servo.h"
#include "keypad.h"
#include "sensor.h"
#include "blockchain.h"

#define STACK_SIZE             4096
#define THREAD_PRIORITY        1
#define PASSCODE_ATTEMPTS      3
#define DEVICE_NAME		       CONFIG_BT_DEVICE_NAME
#define DEVICE_NAME_LEN		   (sizeof(DEVICE_NAME) - 1)
#define MSGQ_SIZE              10
#define MOBILE_CONNECT_TIMEOUT K_SECONDS(10)
#define DISPLAY_BUFFER_SIZE    7
#define SENSOR_MEAS_LENGTH     10
#define SENSOR_SYNC_ATTEMPTS   10
#define MIN_RSSI               -70
#define TARGET_HANDLE          0x0015
#define MAX_NOTIFY_LEN         64

typedef enum {
    STATE_IDLE,
    STATE_SENSOR_CONNECT,
    STATE_SENSOR_SYNC,
    STATE_SENSOR_DATA,
    STATE_SENSOR_DISCONNECT,
    STATE_MOBILE_CONNECT,
    STATE_MOBILE_DATA,
    STATE_MOBILE_DISCONNECT,
    STATE_MOBILE_DISCONNECTION,
    STATE_TAMPERING,
	STATE_PRESENCE,
	STATE_PASSCODE,
	STATE_FAIL,
	STATE_SUCCESS,
	STATE_BLOCKCHAIN,
    STATE_MAX
} system_state_t;

typedef enum {
    EVENT_NONE,
    EVENT_PRESENCE,
    EVENT_TAMPERING,
    EVENT_DISCONNECTION,
    EVENT_FAIL,
    EVENT_SUCCESS
} event_type_t;

extern const char *state_names[STATE_MAX];

extern struct k_msgq user_mac_msgq;
extern struct k_msgq user_passcode_msgq;
extern struct k_sem user_disconnect_sem;
extern struct k_sem sensor_connect_sem;

extern void bluetooth_init(void);
extern void bluetooth_scan(void);
extern void bluetooth_write(const char *string);


#endif
```

## include/fs.h
```c
/*
* @file     fs.h
* @brief    File System Library
* @author   Lachlan Chun, 47484874
*/

#ifndef FS_H
#define FS_H

#include <zephyr/kernel.h>
#include <zephyr/sys/util.h>
#include <zephyr/sys/printk.h>
#include <zephyr/data/json.h>
#include <zephyr/fs/fs.h>
#include <zephyr/fs/littlefs.h>
#include <zephyr/storage/flash_map.h>
#include <zephyr/logging/log.h>
#include <string.h>
#include <stdlib.h>
#include <ctype.h>
#include "user.h"
#include "sensor.h"

extern void fs_init(void);
extern ssize_t fs_read_line(struct fs_file_t *file, char *buf, size_t max_len);

#endif
```

## include/keypad.h
```c
/*
* @file     keypad.h
* @brief    Keypad Library
* @author   Xinlin Zhong, 48018061
*/

#ifndef KEYPAD_H
#define KEYPAD_H

#include <zephyr/kernel.h>
#include <zephyr/device.h>
#include <zephyr/drivers/gpio.h>
#include <zephyr/sys/printk.h>
#include <zephyr/logging/log.h>
#include <stdbool.h>

#define ROW_COUNT 4
#define COL_COUNT 4

extern void keypad_init(void);
extern char keypad_scan(void);

#endif
```

## include/mqtt.h
```c
/*
* @file     mqtt.h
* @brief    MQTT Library
* @author   Lachlan Chun, 47484874
*/

#ifndef MQTT_H
#define MQTT_H

#include <zephyr/kernel.h>
#include <zephyr/net/socket.h>
#include <zephyr/net/mqtt.h>


#endif
```

## include/sensor.h
```c
/*
* @file     sensor.h
* @brief    Sensor Configuration Library
* @author   Lachlan Chun, 47484874
*/

#ifndef SENSOR_H
#define SENSOR_H

#include <zephyr/kernel.h>
#include <zephyr/sys/printk.h>
#include <stdio.h>
#include <stdlib.h>
#include <math.h>

#define THRESHOLD_LENGTH        16
#define MAG_BASELINE_X          -0.845
#define MAG_BASELINE_Y          0.505
#define MAG_BASELINE_Z          0.200
#define MAG_BASELINE_SQ  (MAG_BASELINE_X * MAG_BASELINE_X + MAG_BASELINE_Y * MAG_BASELINE_Y + MAG_BASELINE_Z * MAG_BASELINE_Z)

typedef struct {
    char mag_threshold[THRESHOLD_LENGTH];
    char ultra_threshold[THRESHOLD_LENGTH];
} sensor_threshold_t;

extern const sensor_threshold_t *sensor_get_thresholds(void);
extern void sensor_set_thresholds(const sensor_threshold_t *new_thresholds);
extern void sensor_set_ultrasonic_threshold(double value);
extern void sensor_set_magnetometer_threshold(double value);
extern double sensor_get_ultrasonic_threshold(void);
extern double sensor_get_magnetometer_threshold(void);
extern void sensor_threshold_init(void);

extern struct k_sem sensor_threshold_update_sem;

#endif
```

## include/servo.h
```c
/*
* @file     servo.h
* @brief    Servo Motor Library
* @author   Xinlin Zhong, 48018061
*/

#ifndef SERVO_H
#define SERVO_H

#include <zephyr/kernel.h>
#include <zephyr/sys/printk.h>
#include <zephyr/device.h>
#include <zephyr/drivers/pwm.h>
#include <zephyr/logging/log.h>

extern void servo_init(void);
extern void servo_toggle(void);

#endif
```

## include/user.h
```c
/*
* @file     user.h
* @brief    User Configuration Library
* @author   Lachlan Chun, 47484874
*/

#ifndef USER_H
#define USER_H

#include <zephyr/kernel.h>
#include <zephyr/sys/slist.h>
#include <zephyr/shell/shell.h>
#include <string.h>
#include <stdlib.h>
#include <stdio.h>
#include <ctype.h>

typedef struct {
    char *alias;
    char *mac;
    char *passcode;
    sys_snode_t node;
} user_config_t;

// Status codes
#define USER_SUCCESS 0
#define USER_NOT_FOUND -1
#define USER_ALREADY_EXISTS -2
#define USER_MAC_ALREADY_EXISTS -3
#define USER_MAC_INVALID -4
#define USER_PASSCODE_INVALID -5
#define USER_MEMORY_ERROR -6

#define MAC_ADDRESS_LENGTH 18
#define PASSCODE_LENGTH 5

extern sys_slist_t user_config_list;
extern struct k_mutex user_config_list_mutex;
extern struct k_sem user_list_update_sem;

// Function declarations
int user_add(const char *alias, const char *mac, const char *passcode);
int user_remove(const char *alias);
void user_view(const struct shell *shell, const char *alias);
void user_init(void);

#endif
```
