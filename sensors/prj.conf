## prj.conf
```kconfig
CONFIG_BT=y
CONFIG_BT_PERIPHERAL=y
CONFIG_BT_ZEPHYR_NUS=y
CONFIG_BT_DEVICE_NAME="Sensors Node"
CONFIG_BT_PRIVACY=n
CONFIG_BT_ID_MAX=1
CONFIG_LOG=y

CONFIG_I2C=y
CONFIG_SENSOR=y
CONFIG_GPIO=y
CONFIG_HC_SR04=y
CONFIG_CBPRINTF_FP_SUPPORT=y
```

## boards/disco_l475_iot1.overlay
```dts
/ {
    aliases {
        ultrasonic = &hcsr04_0;
    };

    hcsr04_0: hc_sr04 {
        compatible = "hc-sr04";
        label = "HC_SR04";
        trigger-gpios = <&gpioa 6 GPIO_ACTIVE_HIGH>;
        echo-gpios = <&gpiob 2 GPIO_ACTIVE_HIGH>;
        status = "okay";
    };
};
```

## src/main.c
```c
/*
* @file     main.c
* @brief    Smart Entry System Project - Sensors Node
* @author   Lachlan Chun, 47484874
*/

#include <zephyr/kernel.h>
#include <zephyr/device.h>
#include <zephyr/sys/printk.h>
#include <zephyr/sys/util.h>
#include <zephyr/shell/shell.h>
#include <zephyr/drivers/sensor.h>
#include "bluetooth.h"
#include "time_sync.h"

const struct device *ultrasonic_dev;
const struct device *magnetometer_dev;

void magnetometer_init(void) {
    magnetometer_dev = DEVICE_DT_GET_ONE(st_lis3mdl_magn);

    if (!device_is_ready(magnetometer_dev)) {
        printk("Magnetometer device not ready\n");
        return;
    }
}

void ultrasonic_init(void) {
    ultrasonic_dev = DEVICE_DT_GET(DT_ALIAS(ultrasonic));

    if (ultrasonic_dev == NULL) {
    printk("Failed to get ultrasonic sensor binding");
        return;
    }
}

void magnetometer_measure(const struct device *dev) {
    struct sensor_value magn[3];
    
    if (sensor_sample_fetch(dev) < 0) {
        printf("Magnetometer sample update error\n");
        return;
    }

    if (sensor_channel_get(dev, SENSOR_CHAN_MAGN_XYZ, magn) < 0) {
        printk("Magnetometer channel get failed\n");
        return;
    }

    char msg_buf[21];

    double x = sensor_value_to_double(&magn[0]);
    double y = sensor_value_to_double(&magn[1]);
    double z = sensor_value_to_double(&magn[2]);

    snprintf(msg_buf, sizeof(msg_buf), "%.3f,%.3f,%.3f", x, y, z);

    bluetooth_write(msg_buf, strlen(msg_buf));
    // printk("%s\n", msg_buf);
}

void ultrasonic_measure(const struct device *dev) {
    int ret;
    struct sensor_value distance;

    ret = sensor_sample_fetch_chan(dev, SENSOR_CHAN_ALL);
    switch (ret) {
        case 0:
            ret = sensor_channel_get(dev, SENSOR_CHAN_DISTANCE, &distance);
            if (ret) {
                printk("sensor_channel_get failed ret %d", ret);
                return;
            }

            int integer_part = distance.val1;
            int fractional_part = distance.val2 / 1000;

            char msg_buf[30];
            snprintf(msg_buf, sizeof(msg_buf), "%d.%03d", integer_part, fractional_part);
            bluetooth_write(msg_buf, strlen(msg_buf));
            // printk("%s\n", msg_buf);
            break;
        case -EIO:
            printk("Could not read from ultrasonic device\n");
            break;
        default:
            printk("Error when reading ultrasonic device\n");
            break;
    }
}

// Main.
int main(void) {
    magnetometer_init();
    ultrasonic_init();
    
    bluetooth_init();
    k_msleep(1000);

    while (1) {
        ultrasonic_measure(ultrasonic_dev);
        k_msleep(250);
        magnetometer_measure(magnetometer_dev);
        k_msleep(250);

        update_time_sync_regression();

    }
}
```

## include/bluetooth.h
```c
/*
* @file     bluetooth.h
* @brief    Bluetooth Library
* @author   Xinlin Zhong, 48018061
*/

#ifndef BLUETOOTH_H
#define BLUETOOTH_H

#include <zephyr/device.h>
#include <zephyr/devicetree.h>
#include <stdio.h>
#include <string.h>
#include <zephyr/kernel.h>
#include <zephyr/bluetooth/bluetooth.h>
#include <zephyr/bluetooth/services/nus.h>
#include <stdbool.h>
#include <string.h>

#include <zephyr/logging/log.h>

#define STACKSIZE           4096
#define DEVICE_NAME		    CONFIG_BT_DEVICE_NAME
#define DEVICE_NAME_LEN		(sizeof(DEVICE_NAME) - 1)

extern int bluetooth_init(void);
extern void bluetooth_write(const char *msg, size_t len);
extern uint32_t get_synchronized_time_ms();

#endif
```

## include/time_sync.h
```c
#ifndef TIME_SYNC_LIB_H
#define TIME_SYNC_LIB_H

#include <stdint.h> // For uint32_t, etc.

// Define the maximum number of data points to keep for linear regression.
// A larger window provides more stable results but uses more memory.
#define TIME_SYNC_REGRESSION_WINDOW_SIZE 100

#define REGRESSION_CALC_INTERVAL_MS  2000 // How often to recalculate regression on sensor node

// --- Data Structures ---

// Structure to hold a single data point for regression.
// X typically represents the "master" clock's time, Y the "slave" clock's time.
typedef struct {
    uint32_t x_time; // Timestamp from the reference clock (e.g., MCU A's time)
    uint32_t y_time; // Timestamp from the local clock (e.g., MCU B's time)
} TimeSyncDataPoint_t;

// Structure to hold the current state of the time synchronization.
typedef struct {
    TimeSyncDataPoint_t data_points[TIME_SYNC_REGRESSION_WINDOW_SIZE];
    int data_point_count;
    int next_data_point_index; // For circular buffer management

    // Current regression parameters: y = slope * x + offset
    double slope;
    double offset;

    uint32_t last_regression_calc_time; // Local time when regression was last calculated
    uint32_t last_packet_send_time;     // Local time when last sync packet was sent

} TimeSyncState_t;

extern TimeSyncState_t sensor_node_time_sync_state;


// --- Function Prototypes ---

/**
 * @brief Initializes the time synchronization library state.
 * Should be called once at the start of your application.
 *
 * @param state A pointer to the TimeSyncState_t structure to initialize.
 */
void time_sync_init(TimeSyncState_t *state);

/**
 * @brief Adds a new data point to the regression model's internal buffer.
 * This function should be called whenever a relevant timestamp pair
 * (e.g., received remote time, local time at reception) is available.
 *
 * @param state A pointer to the current TimeSyncState_t.
 * @param x_time The timestamp from the reference clock (e.g., the time value received from the other MCU).
 * @param y_time The timestamp from the local clock (e.g., the local time when the remote timestamp was received).
 */
void time_sync_add_data_point(TimeSyncState_t *state, uint32_t x_time, uint32_t y_time);

/**
 * @brief Performs the linear regression calculation using the stored data points.
 * This function updates the 'slope' and 'offset' in the TimeSyncState_t.
 * It should be called periodically.
 *
 * @param state A pointer to the current TimeSyncState_t.
 */
void time_sync_calculate_regression(TimeSyncState_t *state);

/**
 * @brief Gets the calculated slope from the last regression.
 *
 * @param state A pointer to the current TimeSyncState_t.
 * @return The calculated slope (m) where Y = mX + c.
 */
double time_sync_get_slope(const TimeSyncState_t *state);

/**
 * @brief Gets the calculated offset from the last regression.
 *
 * @param state A pointer to the current TimeSyncState_t.
 * @return The calculated offset (c) where Y = mX + c.
 */
double time_sync_get_offset(const TimeSyncState_t *state);

/**
 * @brief Estimates the remote clock's time based on the local clock and the regression model.
 * This function uses the current local time and the calculated slope/offset
 * to estimate what the reference clock's time would be.
 *
 * @param state A pointer to the current TimeSyncState_t.
 * @param local_time_ms The current timestamp from the local microcontroller's clock.
 * @return An estimated time of the remote clock.
 */
double time_sync_estimate_remote_time(const TimeSyncState_t *state, uint32_t local_time_ms);

/**
 * @brief Estimates the local clock's time if it were synchronized to the remote clock.
 * This function uses the current remote time and the calculated slope/offset
 * to estimate what the local time should be.
 *
 * @param state A pointer to the current TimeSyncState_t.
 * @param remote_time_ms The current timestamp from the remote microcontroller's clock.
 * @return An estimated time of the local clock, if perfectly synced.
 */
double time_sync_estimate_local_synced_time(const TimeSyncState_t *state, uint32_t remote_time_ms);

void update_time_sync_regression();


#endif // TIME_SYNC_LIB_H
```
