## CMakeLists.txt
```
# SPDX-License-Identifier: Apache-2.0

cmake_minimum_required(VERSION 3.20.0)
find_package(Zephyr REQUIRED HINTS $ENV{ZEPHYR_BASE})
project(mobile)

target_sources(app PRIVATE src/main.c)
```

## prj.conf
```kconfig
CONFIG_LV_Z_MEM_POOL_SIZE=16384
CONFIG_LV_Z_SHELL=y
# CONFIG_MAIN_STACK_SIZE=4096

CONFIG_DISPLAY=y
CONFIG_DISPLAY_LOG_LEVEL_ERR=y

# Touch support
CONFIG_INPUT=y
CONFIG_INPUT_FT5336=y

# Required base drivers
CONFIG_I2C=y
CONFIG_GPIO=y

CONFIG_LOG=y
CONFIG_SHELL=y

CONFIG_LVGL=y
CONFIG_LV_USE_LOG=y
CONFIG_LV_USE_LABEL=y
CONFIG_LV_USE_ARC=y
CONFIG_LV_USE_MONKEY=y
CONFIG_LV_FONT_MONTSERRAT_20=y
CONFIG_SYSTEM_WORKQUEUE_STACK_SIZE=2048

CONFIG_BT=y
CONFIG_BT_PERIPHERAL=y
CONFIG_BT_ZEPHYR_NUS=y
CONFIG_BT_DEVICE_NAME="Jess's Device"

# CONFIG_I2C=y
# CONFIG_GPIO_AXP192=y
# CONFIG_REGULATOR=y
# CONFIG_REGULATOR_AXP192=y
# CONFIG_REGULATOR_INIT_PRIORITY=60
# CONFIG_GPIO_INIT_PRIORITY=40

# # Increased stack due to settings API usage
# CONFIG_SYSTEM_WORKQUEUE_STACK_SIZE=2048

# CONFIG_BT=y
# CONFIG_BT_OBSERVER=y

# CONFIG_NEWLIB_LIBC=y
# CONFIG_NEWLIB_LIBC_FLOAT_PRINTF=y
# CONFIG_CBPRINTF_COMPLETE=y
# CONFIG_CBPRINTF_FP_SUPPORT=y
```

## src/main.c
```c
/*
* @file     main.c
* @brief    Project - Mobile
* @author   Xinlin Zhong, 48018061
*/

#include <zephyr/device.h>
#include <zephyr/devicetree.h>
#include <zephyr/drivers/display.h>
#include <zephyr/kernel.h>
#include <zephyr/logging/log.h>
#include <zephyr/bluetooth/bluetooth.h>
#include <zephyr/bluetooth/services/nus.h>
#include <stdio.h>
#include <string.h>
#include <lvgl.h>
#include "lock_img.c"
#include "bluetooth_img.c"
#include "attempts_img.c"
#include "warning_img.c"
#include "enter_img.c"
#include "pass_img.c"
#include "dashline_img.c"

LOG_MODULE_REGISTER(mobile);
void show_incorrect_passcode_img(void);

#define MAX_CIRCLES 4
#define MSGQ_SIZE               20    // Message queue size
#define MAX_NAME_LEN 16
#define STACKSIZE               4096
#define DEVICE_NAME		    CONFIG_BT_DEVICE_NAME
#define DEVICE_NAME_LEN		(sizeof(DEVICE_NAME) - 1)

static lv_obj_t *lock_imgage;
static lv_obj_t *ble_imgage;
static lv_obj_t *enter_text;
static lv_obj_t *attempts_text;
static lv_obj_t *dashline;
static lv_obj_t *warning;
static lv_obj_t *pass;
static lv_obj_t *num_attempts;
static lv_obj_t *first_digit;
static lv_obj_t *second_digit;
static lv_obj_t *third_digit;
static lv_obj_t *fourth_digit;

K_MSGQ_DEFINE(data_msgq, MAX_NAME_LEN, MSGQ_SIZE, 4);
K_SEM_DEFINE(conn_status_sem, 0, 1);
bool is_connected = false;

static const struct bt_data ad[] = {
	BT_DATA_BYTES(BT_DATA_FLAGS, (BT_LE_AD_GENERAL | BT_LE_AD_NO_BREDR)),
	BT_DATA(BT_DATA_NAME_COMPLETE, DEVICE_NAME, DEVICE_NAME_LEN),
};

static const struct bt_data sd[] = {
	BT_DATA_BYTES(BT_DATA_UUID128_ALL, BT_UUID_NUS_SRV_VAL),
};

static struct k_work_delayable adv_restart_work;

static void notif_enabled(bool enabled, void *ctx) {
	ARG_UNUSED(ctx);

	printk("%s() - %s\n", __func__, (enabled ? "Enabled" : "Disabled"));
}

static void received(struct bt_conn *conn, const void *data, uint16_t len, void *ctx) {
	ARG_UNUSED(conn);
	ARG_UNUSED(ctx);

    if (len > 0 && len < MAX_NAME_LEN) {
        char received[MAX_NAME_LEN] = {0};
        memcpy(received, data, len);
        received[len] = '\0';  
        k_msgq_put(&data_msgq, &received, K_NO_WAIT);
    }
}

static void connected(struct bt_conn *conn, uint8_t err) {
    if (err) {
        printk("Connection failed (err %u)\n", err);
    } else {
        printk("Connected\n");
        is_connected = true;
        k_sem_give(&conn_status_sem);
    }
}

void adv_restart_fn(struct k_work *work) {
    int err = bt_le_adv_start(BT_LE_ADV_CONN_FAST_1, ad, ARRAY_SIZE(ad), sd, ARRAY_SIZE(sd));
    if (err) {
        printk("Deferred advertising restart failed (err %d)\n", err);
    } else {
        printk("Advertising restarted (deferred)\n");
    }
}

static void disconnected(struct bt_conn *conn, uint8_t reason) {
    printk("Disconnected (reason %u)\n", reason);
    is_connected = false;
    k_sem_give(&conn_status_sem);
    k_work_schedule(&adv_restart_work, K_MSEC(500));
}

static struct bt_conn_cb conn_callbacks = {
    .connected = connected,
    .disconnected = disconnected,
};

struct bt_nus_cb nus_listener = {
	.notif_enabled = notif_enabled,
	.received = received,
};

int set_up_ble(void) {
    int err;

	printk("Sample - Bluetooth Peripheral NUS\n");

	err = bt_nus_cb_register(&nus_listener, NULL);
	if (err) {
		printk("Failed to register NUS callback: %d\n", err);
		return err;
	}

	err = bt_enable(NULL);
	if (err) {
		printk("Failed to enable bluetooth: %d\n", err);
		return err;
	}

	err = bt_le_adv_start(BT_LE_ADV_CONN_FAST_1, ad, ARRAY_SIZE(ad), sd, ARRAY_SIZE(sd));
	if (err) {
		printk("Failed to start advertising: %d\n", err);
		return err;
	}

	printk("Initialization complete\n");

    return 0;
}

static void hide_image_cb(lv_timer_t *timer) {
    lv_obj_t *img = (lv_obj_t *)lv_timer_get_user_data(timer);
    lv_obj_add_flag(img, LV_OBJ_FLAG_HIDDEN);  // hide iamge
    lv_timer_del(timer);
}

void show_incorrect_passcode_img(void) {
    lv_obj_clear_flag(lock_imgage, LV_OBJ_FLAG_HIDDEN);  // show image
    lv_timer_t *timer = lv_timer_create(hide_image_cb, 1500, lock_imgage);
    lv_timer_set_repeat_count(timer, 1);
}

void init_interface_thread(void *, void *, void *) {

    const struct device *display_dev = DEVICE_DT_GET(DT_CHOSEN(zephyr_display));
    if (!device_is_ready(display_dev)) {
        LOG_ERR("Display not ready");
        return;
    }

    // init_images();
    display_blanking_off(display_dev);

    while (1) {
        lv_timer_handler();
        k_sleep(K_MSEC(10));
    }
}

void config_images(void) {
    ble_imgage = lv_img_create(lv_scr_act());
    lv_img_set_src(ble_imgage, &bluetooth_img);  
    lv_obj_set_pos(ble_imgage, 270, 10);

    attempts_text = lv_img_create(lv_scr_act());
    lv_img_set_src(attempts_text, &attempts_img);  
    lv_obj_set_pos(attempts_text, 5, 4);

    enter_text = lv_img_create(lv_scr_act());
    lv_img_set_src(enter_text, &enter_img);  
    lv_obj_set_pos(enter_text, 77, 80);

    dashline = lv_img_create(lv_scr_act());
    lv_img_set_src(dashline, &dashline_img);  
    lv_obj_set_pos(dashline, 40, 190);

    warning = lv_img_create(lv_scr_act());
    lv_img_set_src(warning, &warning_img);  
    lv_obj_set_pos(warning, 65, 25);

    pass = lv_img_create(lv_scr_act());
    lv_img_set_src(pass, &pass_img);  
    lv_obj_set_pos(pass, 5, 10);

    lock_imgage = lv_img_create(lv_scr_act());
    lv_img_set_src(lock_imgage, &lock_img);  
    lv_obj_set_pos(lock_imgage, 230, 10);
}

void config_labels(void) {
    num_attempts = lv_label_create(lv_scr_act());
    first_digit = lv_label_create(lv_scr_act());
    second_digit = lv_label_create(lv_scr_act());
    third_digit = lv_label_create(lv_scr_act());
    fourth_digit = lv_label_create(lv_scr_act());

    lv_obj_set_pos(num_attempts, 190, 20);
    lv_obj_set_pos(first_digit, 55, 160);
    lv_obj_set_pos(second_digit, 120, 160);
    lv_obj_set_pos(third_digit, 180, 160);
    lv_obj_set_pos(fourth_digit, 240, 160);

    lv_obj_set_style_text_font(num_attempts, &lv_font_montserrat_20, LV_PART_MAIN);
    lv_obj_set_style_text_font(first_digit, &lv_font_montserrat_20, LV_PART_MAIN);
    lv_obj_set_style_text_font(second_digit, &lv_font_montserrat_20, LV_PART_MAIN);
    lv_obj_set_style_text_font(third_digit, &lv_font_montserrat_20, LV_PART_MAIN);
    lv_obj_set_style_text_font(fourth_digit, &lv_font_montserrat_20, LV_PART_MAIN);
}

void disable_labels(void) {
    lv_label_set_text(num_attempts, "");
    lv_label_set_text(first_digit, "");
    lv_label_set_text(second_digit, "");
    lv_label_set_text(third_digit, "");
    lv_label_set_text(fourth_digit, "");
}

void only_display_fail(void) {
    lv_obj_clear_flag(warning, LV_OBJ_FLAG_HIDDEN);
    lv_obj_add_flag(ble_imgage, LV_OBJ_FLAG_HIDDEN);
    lv_obj_add_flag(pass, LV_OBJ_FLAG_HIDDEN);
    lv_obj_add_flag(attempts_text, LV_OBJ_FLAG_HIDDEN);
    lv_obj_add_flag(enter_text, LV_OBJ_FLAG_HIDDEN);
    lv_obj_add_flag(dashline, LV_OBJ_FLAG_HIDDEN);
    lv_obj_add_flag(lock_imgage, LV_OBJ_FLAG_HIDDEN);
}

void only_display_pass(void) {
    lv_obj_clear_flag(pass, LV_OBJ_FLAG_HIDDEN);
    lv_obj_add_flag(ble_imgage, LV_OBJ_FLAG_HIDDEN);
    lv_obj_add_flag(attempts_text, LV_OBJ_FLAG_HIDDEN);
    lv_obj_add_flag(enter_text, LV_OBJ_FLAG_HIDDEN);
    lv_obj_add_flag(dashline, LV_OBJ_FLAG_HIDDEN);
    lv_obj_add_flag(lock_imgage, LV_OBJ_FLAG_HIDDEN);
    lv_obj_add_flag(warning, LV_OBJ_FLAG_HIDDEN);
}

void update_interface_thread(void *, void *, void *) {

    config_images();
    config_labels();

    is_connected = false;
    k_sem_give(&conn_status_sem);

    char received[MAX_NAME_LEN] = {0};

    while (1) {
        // Clear buffer
        memset(received, 0, sizeof(received));  

        if (!k_msgq_get(&data_msgq, &received, K_NO_WAIT)) {
            printk("Recevied Data: %s\n", received);
            if (strlen(received) == 6 && received[1] == ':') {
                lv_label_set_text(num_attempts, (received[0] == '-') ? "" : (char[2]){received[0], '\0'});
                lv_label_set_text(first_digit, (received[2] == '-') ? "" : (char[2]){received[2], '\0'});
                lv_label_set_text(second_digit, (received[3] == '-') ? "" : (char[2]){received[3], '\0'});
                lv_label_set_text(third_digit, (received[4] == '-') ? "" : (char[2]){received[4], '\0'});
                lv_label_set_text(fourth_digit, (received[5] == '-') ? "" : (char[2]){received[5], '\0'});
            } else if (strlen(received) == 1) {
                switch (received[0]) {
                    case 'N':
                        show_incorrect_passcode_img();
                        break;
                    case 'Y':
                        only_display_pass();
                        break;
                    case 'F':
                        only_display_fail();
                        break;
                }
            }
        }
        k_sleep(K_MSEC(10)); 
    }
}

void ui_setup_connection_thread(void *, void *, void *) {

    while (1) {
        k_sem_take(&conn_status_sem, K_FOREVER);
        if (is_connected) {
            lv_obj_clear_flag(ble_imgage, LV_OBJ_FLAG_HIDDEN);
            lv_obj_clear_flag(attempts_text, LV_OBJ_FLAG_HIDDEN);
            lv_obj_clear_flag(enter_text, LV_OBJ_FLAG_HIDDEN);
            lv_obj_clear_flag(dashline, LV_OBJ_FLAG_HIDDEN);
        } else {
            // Hide everything when disconnected
            lv_obj_add_flag(ble_imgage, LV_OBJ_FLAG_HIDDEN);
            lv_obj_add_flag(attempts_text, LV_OBJ_FLAG_HIDDEN);
            lv_obj_add_flag(enter_text, LV_OBJ_FLAG_HIDDEN);
            lv_obj_add_flag(dashline, LV_OBJ_FLAG_HIDDEN);
            lv_obj_add_flag(warning, LV_OBJ_FLAG_HIDDEN);
            lv_obj_add_flag(pass, LV_OBJ_FLAG_HIDDEN);
            lv_obj_add_flag(lock_imgage, LV_OBJ_FLAG_HIDDEN);
        }
        disable_labels();
        k_sleep(K_MSEC(100)); 
    }
}

void ble_thread(void *, void *, void *) {
    set_up_ble();
    bt_conn_cb_register(&conn_callbacks);
    k_work_init_delayable(&adv_restart_work, adv_restart_fn);

    while (1) {
        k_sleep(K_MSEC(100)); 
    }
}

K_THREAD_DEFINE(ble_tid, 2048, ble_thread, NULL, NULL, NULL, 5, 0, 0); // priority 2 (lower)
K_THREAD_DEFINE(init_tid, 4096, init_interface_thread, NULL, NULL, NULL, 7, 0, 0);
K_THREAD_DEFINE(update_tid, 2048, update_interface_thread, NULL, NULL, NULL, 7, 0, 0);
K_THREAD_DEFINE(ui_setup_tid, 1024, ui_setup_connection_thread, NULL, NULL, NULL, 7, 0, 0);
```

## src/bluetooth_img.c
```c
#ifdef __has_include
    #if __has_include("lvgl.h")
        #ifndef LV_LVGL_H_INCLUDE_SIMPLE
            #define LV_LVGL_H_INCLUDE_SIMPLE
        #endif
    #endif
#endif

#if defined(LV_LVGL_H_INCLUDE_SIMPLE)
    #include "lvgl.h"
#else
    #include "lvgl/lvgl.h"
#endif


#ifndef LV_ATTRIBUTE_MEM_ALIGN
#define LV_ATTRIBUTE_MEM_ALIGN
#endif

#ifndef LV_ATTRIBUTE_IMAGE_BLUETOOTH_IMG
#define LV_ATTRIBUTE_IMAGE_BLUETOOTH_IMG
#endif

const LV_ATTRIBUTE_MEM_ALIGN LV_ATTRIBUTE_LARGE_CONST LV_ATTRIBUTE_IMAGE_BLUETOOTH_IMG uint8_t bluetooth_img_map[] = {
  0xdf, 0xff, 0xdf, 0xff, 0xdf, 0xff, 0xdf, 0xff, 0xdf, 0xff, 0xdf, 0xff, 0xdf, 0xff, 0xdf, 0xff, 0xdf, 0xff, 0xdf, 0xff, 0xbf, 0xff, 0xff, 0xff, 0xff, 0xff, 0xbf, 0xf7, 0xfe, 0xd6, 0x1c, 0xae, 0x7b, 0x8d, 0x1b, 0x75, 0xfb, 0x6c, 0x1b, 0x7d, 0xbb, 0x9d, 0x5c, 0xbe, 0x3e, 0xdf, 0xdf, 0xff, 0xff, 0xff, 0xdf, 0xff, 0xbf, 0xff, 0xdf, 0xff, 0xdf, 0xff, 0xdf, 0xff, 0xdf, 0xff, 0xdf, 0xff, 0xdf, 0xff, 0xdf, 0xff, 0xdf, 0xff, 0xdf, 0xff, 0xdf, 0xff, 
  0xdf, 0xff, 0xdf, 0xff, 0xdf, 0xff, 0xdf, 0xff, 0xdf, 0xff, 0xdf, 0xff, 0xdf, 0xff, 0xdf, 0xff, 0xdf, 0xff, 0xdf, 0xff, 0xff, 0xff, 0x7e, 0xef, 0x1c, 0xae, 0x9a, 0x54, 0xd9, 0x03, 0xb9, 0x03, 0xd9, 0x03, 0xfa, 0x03, 0x1a, 0x04, 0xfa, 0x03, 0xd9, 0x03, 0xb9, 0x03, 0xfa, 0x03, 0xfb, 0x6c, 0x9d, 0xc6, 0xbf, 0xff, 0xff, 0xff, 0xbf, 0xff, 0xdf, 0xff, 0xdf, 0xff, 0xdf, 0xff, 0xdf, 0xff, 0xdf, 0xff, 0xdf, 0xff, 0xdf, 0xff, 0xdf, 0xff, 0xdf, 0xff, 
  0xdf, 0xff, 0xdf, 0xff, 0xdf, 0xff, 0xdf, 0xff, 0xdf, 0xff, 0xdf, 0xff, 0xdf, 0xff, 0xdf, 0xff, 0xdf, 0xff, 0xdf, 0xff, 0x5c, 0xbe, 0x3a, 0x2c, 0xb9, 0x03, 0x1a, 0x04, 0x5a, 0x34, 0x5a, 0x34, 0x5a, 0x2c, 0x5a, 0x2c, 0x5a, 0x2c, 0x5a, 0x2c, 0x5a, 0x34, 0x5a, 0x34, 0x5a, 0x2c, 0xfa, 0x03, 0xb9, 0x03, 0xda, 0x64, 0xfd, 0xd6, 0xff, 0xff, 0xdf, 0xff, 0xdf, 0xff, 0xdf, 0xff, 0xdf, 0xff, 0xdf, 0xff, 0xdf, 0xff, 0xdf, 0xff, 0xdf, 0xff, 0xdf, 0xff, 
  0xdf, 0xff, 0xdf, 0xff, 0xdf, 0xff, 0xdf, 0xff, 0xdf, 0xff, 0xdf, 0xff, 0xdf, 0xff, 0xdf, 0xff, 0xbf, 0xf7, 0x7b, 0x8d, 0x99, 0x03, 0x3a, 0x1c, 0x5a, 0x3c, 0x3a, 0x2c, 0x3a, 0x24, 0x3a, 0x24, 0x3a, 0x24, 0x3a, 0x24, 0x3a, 0x24, 0x3a, 0x24, 0x3a, 0x24, 0x3a, 0x24, 0x3a, 0x24, 0x5a, 0x34, 0x5a, 0x3c, 0x1a, 0x04, 0xd9, 0x03, 0x5d, 0xb6, 0xff, 0xff, 0xdf, 0xff, 0xdf, 0xff, 0xdf, 0xff, 0xdf, 0xff, 0xdf, 0xff, 0xdf, 0xff, 0xdf, 0xff, 0xdf, 0xff, 
  0xdf, 0xff, 0xdf, 0xff, 0xdf, 0xff, 0xdf, 0xff, 0xdf, 0xff, 0xdf, 0xff, 0xdf, 0xff, 0xbf, 0xf7, 0x1b, 0x75, 0xb9, 0x03, 0x5a, 0x3c, 0x3a, 0x2c, 0x3a, 0x24, 0x3a, 0x24, 0x3a, 0x24, 0x3a, 0x24, 0x3a, 0x24, 0x5a, 0x2c, 0x3a, 0x2c, 0x5a, 0x34, 0x3a, 0x24, 0x3a, 0x24, 0x3a, 0x24, 0x3a, 0x24, 0x3a, 0x24, 0x5a, 0x34, 0x5a, 0x34, 0x99, 0x03, 0x1c, 0xae, 0xff, 0xff, 0xdf, 0xff, 0xdf, 0xff, 0xdf, 0xff, 0xdf, 0xff, 0xdf, 0xff, 0xdf, 0xff, 0xdf, 0xff, 
  0xdf, 0xff, 0xdf, 0xff, 0xdf, 0xff, 0xdf, 0xff, 0xdf, 0xff, 0xdf, 0xff, 0xdf, 0xff, 0x5b, 0x8d, 0xb9, 0x03, 0x7a, 0x3c, 0x3a, 0x24, 0x3a, 0x24, 0x3a, 0x24, 0x3a, 0x24, 0x3a, 0x24, 0x3a, 0x24, 0x3a, 0x24, 0xf9, 0x03, 0x1a, 0x1c, 0xf9, 0x03, 0x5a, 0x34, 0x3a, 0x24, 0x3a, 0x24, 0x3a, 0x24, 0x3a, 0x24, 0x3a, 0x24, 0x3a, 0x24, 0x5a, 0x3c, 0x99, 0x03, 0x7d, 0xbe, 0xff, 0xff, 0xbf, 0xff, 0xdf, 0xff, 0xdf, 0xff, 0xdf, 0xff, 0xdf, 0xff, 0xdf, 0xff, 
  0xdf, 0xff, 0xdf, 0xff, 0xdf, 0xff, 0xdf, 0xff, 0xbf, 0xff, 0xff, 0xff, 0x5d, 0xbe, 0x99, 0x03, 0x5a, 0x3c, 0x3a, 0x24, 0x3a, 0x24, 0x3a, 0x24, 0x3a, 0x24, 0x3a, 0x24, 0x3a, 0x24, 0x5a, 0x2c, 0xf9, 0x03, 0x7d, 0xbe, 0xbf, 0xf7, 0xdc, 0x9d, 0xb9, 0x03, 0x5a, 0x3c, 0x3a, 0x24, 0x3a, 0x24, 0x3a, 0x24, 0x3a, 0x24, 0x3a, 0x24, 0x3a, 0x2c, 0x3a, 0x2c, 0xfa, 0x03, 0x3e, 0xe7, 0xff, 0xff, 0xbf, 0xff, 0xdf, 0xff, 0xdf, 0xff, 0xdf, 0xff, 0xdf, 0xff, 
  0xdf, 0xff, 0xdf, 0xff, 0xdf, 0xff, 0xdf, 0xff, 0xff, 0xff, 0x7e, 0xef, 0x3a, 0x24, 0x3a, 0x24, 0x3a, 0x2c, 0x3a, 0x24, 0x3a, 0x24, 0x3a, 0x24, 0x3a, 0x24, 0x3a, 0x24, 0x3a, 0x2c, 0x1a, 0x04, 0x9a, 0x4c, 0xdf, 0xff, 0xff, 0xff, 0xff, 0xff, 0xdc, 0x9d, 0x99, 0x03, 0x5a, 0x3c, 0x3a, 0x24, 0x3a, 0x24, 0x3a, 0x24, 0x3a, 0x24, 0x3a, 0x24, 0x5a, 0x34, 0xf9, 0x03, 0x3b, 0x7d, 0xdf, 0xff, 0xdf, 0xff, 0xdf, 0xff, 0xdf, 0xff, 0xdf, 0xff, 0xdf, 0xff, 
  0xdf, 0xff, 0xdf, 0xff, 0xdf, 0xff, 0xbf, 0xff, 0xff, 0xff, 0xfc, 0xa5, 0xb9, 0x03, 0x5a, 0x3c, 0x3a, 0x24, 0x3a, 0x24, 0x3a, 0x24, 0x3a, 0x24, 0x3a, 0x24, 0x3a, 0x24, 0x3a, 0x2c, 0x1a, 0x04, 0x9a, 0x4c, 0xbf, 0xf7, 0xff, 0xff, 0xff, 0xff, 0xff, 0xff, 0xdc, 0x9d, 0xb9, 0x03, 0x5a, 0x3c, 0x3a, 0x24, 0x3a, 0x24, 0x3a, 0x24, 0x3a, 0x24, 0x3a, 0x24, 0x5a, 0x34, 0xd9, 0x03, 0xfd, 0xd6, 0xff, 0xff, 0xbf, 0xff, 0xdf, 0xff, 0xdf, 0xff, 0xdf, 0xff, 
  0xdf, 0xff, 0xdf, 0xff, 0xdf, 0xff, 0xdf, 0xff, 0x9f, 0xf7, 0x9a, 0x54, 0x1a, 0x04, 0x3a, 0x2c, 0x3a, 0x24, 0x3a, 0x24, 0x3a, 0x24, 0x3a, 0x24, 0x3a, 0x24, 0x3a, 0x24, 0x3a, 0x2c, 0x1a, 0x04, 0x9a, 0x4c, 0xbf, 0xf7, 0xff, 0xff, 0xff, 0xff, 0xff, 0xff, 0xff, 0xff, 0xdc, 0x9d, 0xb9, 0x03, 0x5a, 0x3c, 0x3a, 0x24, 0x3a, 0x24, 0x3a, 0x24, 0x3a, 0x24, 0x5a, 0x34, 0xd9, 0x03, 0xbb, 0x95, 0xff, 0xff, 0xdf, 0xff, 0xdf, 0xff, 0xdf, 0xff, 0xdf, 0xff, 
  0xdf, 0xff, 0xdf, 0xff, 0xbf, 0xff, 0xff, 0xff, 0xfe, 0xd6, 0xd9, 0x03, 0x5a, 0x34, 0x3a, 0x24, 0x3a, 0x24, 0x3a, 0x24, 0x3a, 0x24, 0x5a, 0x34, 0x3a, 0x2c, 0x3a, 0x24, 0x3a, 0x2c, 0x1a, 0x04, 0x9a, 0x4c, 0xbf, 0xf7, 0xff, 0xff, 0xff, 0xff, 0xff, 0xff, 0xff, 0xff, 0xff, 0xff, 0xbc, 0x9d, 0xb9, 0x03, 0x5a, 0x3c, 0x3a, 0x24, 0x3a, 0x24, 0x3a, 0x24, 0x3a, 0x2c, 0x1a, 0x04, 0x9a, 0x54, 0x9f, 0xf7, 0xdf, 0xff, 0xdf, 0xff, 0xdf, 0xff, 0xdf, 0xff, 
  0xdf, 0xff, 0xdf, 0xff, 0xbf, 0xff, 0xff, 0xff, 0x5c, 0xb6, 0xb9, 0x03, 0x5a, 0x34, 0x3a, 0x24, 0x3a, 0x24, 0x3a, 0x24, 0x3a, 0x2c, 0xd9, 0x03, 0x1a, 0x0c, 0x5a, 0x2c, 0x3a, 0x2c, 0x1a, 0x04, 0x9a, 0x4c, 0xbf, 0xf7, 0xff, 0xff, 0xfd, 0xd6, 0x3c, 0xbe, 0xff, 0xff, 0xff, 0xff, 0xff, 0xff, 0xbc, 0x95, 0xb9, 0x03, 0x5a, 0x34, 0x3a, 0x24, 0x3a, 0x24, 0x3a, 0x24, 0x3a, 0x2c, 0xfa, 0x03, 0x3e, 0xdf, 0xff, 0xff, 0xbf, 0xff, 0xdf, 0xff, 0xdf, 0xff, 
  0xdf, 0xff, 0xdf, 0xff, 0xdf, 0xff, 0xff, 0xff, 0xbc, 0x9d, 0xd9, 0x03, 0x5a, 0x34, 0x3a, 0x24, 0x3a, 0x24, 0x3a, 0x24, 0x1a, 0x04, 0x5b, 0x85, 0x9a, 0x4c, 0xf9, 0x03, 0x5a, 0x3c, 0x1a, 0x04, 0x9a, 0x4c, 0xbf, 0xf7, 0xff, 0xff, 0x1e, 0xdf, 0xd6, 0x02, 0x7c, 0xc6, 0xff, 0xff, 0xff, 0xff, 0xff, 0xff, 0x9c, 0x95, 0xd9, 0x03, 0x5a, 0x34, 0x3a, 0x24, 0x3a, 0x24, 0x5a, 0x34, 0xd9, 0x03, 0xbd, 0xce, 0xff, 0xff, 0xbf, 0xff, 0xdf, 0xff, 0xdf, 0xff, 
  0xdf, 0xff, 0xdf, 0xff, 0xdf, 0xff, 0xff, 0xff, 0x7b, 0x8d, 0xd9, 0x03, 0x5a, 0x34, 0x3a, 0x24, 0x5a, 0x34, 0xd9, 0x03, 0x5d, 0xb6, 0xff, 0xff, 0x9f, 0xef, 0xba, 0x64, 0xf9, 0x03, 0x3a, 0x24, 0x9a, 0x4c, 0xbf, 0xf7, 0xff, 0xff, 0x1e, 0xdf, 0xf9, 0x03, 0x57, 0x03, 0x5c, 0xbe, 0xff, 0xff, 0xff, 0xff, 0xff, 0xff, 0x3b, 0x7d, 0xfa, 0x03, 0x5a, 0x34, 0x3a, 0x24, 0x5a, 0x34, 0xb9, 0x03, 0x9d, 0xc6, 0xff, 0xff, 0xbf, 0xff, 0xdf, 0xff, 0xdf, 0xff, 
  0xdf, 0xff, 0xdf, 0xff, 0xdf, 0xff, 0xff, 0xff, 0x5b, 0x8d, 0xd9, 0x03, 0x5a, 0x34, 0x3a, 0x24, 0x5a, 0x34, 0xb9, 0x03, 0xde, 0xce, 0xff, 0xff, 0xff, 0xff, 0xbf, 0xf7, 0xba, 0x64, 0xd9, 0x03, 0xba, 0x5c, 0xbf, 0xf7, 0xff, 0xff, 0x1e, 0xdf, 0x3a, 0x1c, 0x99, 0x03, 0x5a, 0x95, 0xff, 0xff, 0xff, 0xff, 0xff, 0xff, 0xbc, 0x95, 0xd9, 0x03, 0x5a, 0x34, 0x3a, 0x24, 0x5a, 0x34, 0xb9, 0x03, 0x7d, 0xbe, 0xff, 0xff, 0xbf, 0xff, 0xdf, 0xff, 0xdf, 0xff, 
  0xdf, 0xff, 0xdf, 0xff, 0xdf, 0xff, 0xff, 0xff, 0x7b, 0x8d, 0xd9, 0x03, 0x5a, 0x34, 0x3a, 0x24, 0x3a, 0x2c, 0x3a, 0x1c, 0x18, 0x2c, 0x3e, 0xe7, 0xff, 0xff, 0xff, 0xff, 0xbf, 0xf7, 0x9a, 0x54, 0x5a, 0x3c, 0xbf, 0xf7, 0xff, 0xff, 0x3e, 0xdf, 0x59, 0x03, 0x9c, 0x8d, 0xff, 0xff, 0xff, 0xff, 0xff, 0xff, 0x9c, 0xc6, 0xb9, 0x03, 0x5a, 0x2c, 0x3a, 0x24, 0x3a, 0x24, 0x5a, 0x34, 0xb9, 0x03, 0x7d, 0xc6, 0xff, 0xff, 0xbf, 0xff, 0xdf, 0xff, 0xdf, 0xff, 
  0xdf, 0xff, 0xdf, 0xff, 0xdf, 0xff, 0xff, 0xff, 0x5b, 0x8d, 0xd9, 0x03, 0x5a, 0x34, 0x3a, 0x24, 0x3a, 0x24, 0x5a, 0x2c, 0xd9, 0x03, 0xd7, 0x2b, 0x5e, 0xe7, 0xff, 0xff, 0xff, 0xff, 0x9f, 0xef, 0xfb, 0x6c, 0x9f, 0xef, 0xff, 0xff, 0xfe, 0xd6, 0x3b, 0x85, 0xff, 0xff, 0xff, 0xff, 0xff, 0xff, 0x9d, 0xce, 0x37, 0x03, 0x39, 0x24, 0x3a, 0x2c, 0x3a, 0x24, 0x3a, 0x24, 0x5a, 0x34, 0xb9, 0x03, 0x7d, 0xbe, 0xff, 0xff, 0xbf, 0xff, 0xdf, 0xff, 0xdf, 0xff, 
  0xdf, 0xff, 0xdf, 0xff, 0xdf, 0xff, 0xff, 0xff, 0x5b, 0x8d, 0xd9, 0x03, 0x5a, 0x34, 0x3a, 0x24, 0x3a, 0x24, 0x3a, 0x24, 0x5a, 0x34, 0xd9, 0x03, 0xf7, 0x33, 0x5e, 0xe7, 0xff, 0xff, 0xff, 0xff, 0xbf, 0xf7, 0xdf, 0xff, 0xff, 0xff, 0xbf, 0xf7, 0xdf, 0xff, 0xff, 0xff, 0xff, 0xff, 0x9d, 0xce, 0x37, 0x03, 0x39, 0x2c, 0x5a, 0x2c, 0x3a, 0x24, 0x3a, 0x24, 0x3a, 0x24, 0x5a, 0x34, 0xb9, 0x03, 0x7d, 0xbe, 0xff, 0xff, 0xbf, 0xff, 0xdf, 0xff, 0xdf, 0xff, 
  0xdf, 0xff, 0xdf, 0xff, 0xdf, 0xff, 0xff, 0xff, 0x5b, 0x8d, 0xd9, 0x03, 0x5a, 0x34, 0x3a, 0x24, 0x3a, 0x24, 0x3a, 0x24, 0x3a, 0x24, 0x5a, 0x34, 0xd8, 0x03, 0xf7, 0x3b, 0x5e, 0xef, 0xff, 0xff, 0xff, 0xff, 0xff, 0xff, 0xff, 0xff, 0xff, 0xff, 0xff, 0xff, 0xff, 0xff, 0xbd, 0xce, 0x37, 0x03, 0x39, 0x2c, 0x5a, 0x2c, 0x3a, 0x24, 0x3a, 0x24, 0x3a, 0x24, 0x3a, 0x24, 0x5a, 0x34, 0xb9, 0x03, 0x7d, 0xbe, 0xff, 0xff, 0xbf, 0xff, 0xdf, 0xff, 0xdf, 0xff, 
  0xdf, 0xff, 0xdf, 0xff, 0xdf, 0xff, 0xff, 0xff, 0x5b, 0x8d, 0xd9, 0x03, 0x5a, 0x34, 0x3a, 0x24, 0x3a, 0x24, 0x3a, 0x24, 0x3a, 0x24, 0x3a, 0x24, 0x5a, 0x34, 0xd8, 0x03, 0xf7, 0x3b, 0x7e, 0xef, 0xff, 0xff, 0xff, 0xff, 0xff, 0xff, 0xff, 0xff, 0xff, 0xff, 0xbd, 0xce, 0x57, 0x03, 0x39, 0x2c, 0x5a, 0x2c, 0x3a, 0x24, 0x3a, 0x24, 0x3a, 0x24, 0x3a, 0x24, 0x3a, 0x24, 0x5a, 0x34, 0xb9, 0x03, 0x7d, 0xbe, 0xff, 0xff, 0xbf, 0xff, 0xdf, 0xff, 0xdf, 0xff, 
  0xdf, 0xff, 0xdf, 0xff, 0xdf, 0xff, 0xff, 0xff, 0x5b, 0x8d, 0xd9, 0x03, 0x5a, 0x34, 0x3a, 0x24, 0x3a, 0x24, 0x3a, 0x24, 0x3a, 0x24, 0x3a, 0x24, 0x3a, 0x24, 0x5a, 0x34, 0xd9, 0x03, 0xd7, 0x2b, 0x7f, 0xef, 0xff, 0xff, 0xff, 0xff, 0xff, 0xff, 0xbd, 0xce, 0x16, 0x03, 0x39, 0x34, 0x5a, 0x2c, 0x3a, 0x24, 0x3a, 0x24, 0x3a, 0x24, 0x3a, 0x24, 0x3a, 0x24, 0x3a, 0x24, 0x5a, 0x34, 0xb9, 0x03, 0x7d, 0xbe, 0xff, 0xff, 0xbf, 0xff, 0xdf, 0xff, 0xdf, 0xff, 
  0xdf, 0xff, 0xdf, 0xff, 0xdf, 0xff, 0xff, 0xff, 0x5b, 0x8d, 0xd9, 0x03, 0x5a, 0x34, 0x3a, 0x24, 0x3a, 0x24, 0x3a, 0x24, 0x3a, 0x24, 0x3a, 0x24, 0x3a, 0x24, 0x5a, 0x3c, 0xd9, 0x03, 0xfa, 0x7c, 0xbf, 0xf7, 0xff, 0xff, 0xff, 0xff, 0xff, 0xff, 0x3e, 0xe7, 0x59, 0x3c, 0x1a, 0x04, 0x5a, 0x34, 0x3a, 0x24, 0x3a, 0x24, 0x3a, 0x24, 0x3a, 0x24, 0x3a, 0x24, 0x3a, 0x24, 0x5a, 0x34, 0xb9, 0x03, 0x7d, 0xbe, 0xff, 0xff, 0xbf, 0xff, 0xdf, 0xff, 0xdf, 0xff, 
  0xdf, 0xff, 0xdf, 0xff, 0xdf, 0xff, 0xff, 0xff, 0x5b, 0x8d, 0xd9, 0x03, 0x5a, 0x34, 0x3a, 0x24, 0x3a, 0x24, 0x3a, 0x24, 0x3a, 0x24, 0x3a, 0x24, 0x5a, 0x3c, 0xd9, 0x03, 0x3b, 0x7d, 0xff, 0xff, 0xff, 0xff, 0xff, 0xff, 0xff, 0xff, 0xff, 0xff, 0xff, 0xff, 0x7f, 0xe7, 0x5a, 0x3c, 0x1a, 0x04, 0x5a, 0x34, 0x3a, 0x24, 0x3a, 0x24, 0x3a, 0x24, 0x3a, 0x24, 0x3a, 0x24, 0x5a, 0x34, 0xb9, 0x03, 0x7d, 0xbe, 0xff, 0xff, 0xbf, 0xff, 0xdf, 0xff, 0xdf, 0xff, 
  0xdf, 0xff, 0xdf, 0xff, 0xdf, 0xff, 0xff, 0xff, 0x5b, 0x8d, 0xd9, 0x03, 0x5a, 0x34, 0x3a, 0x24, 0x3a, 0x24, 0x3a, 0x24, 0x3a, 0x24, 0x5a, 0x3c, 0xd9, 0x03, 0x1b, 0x7d, 0xff, 0xff, 0xff, 0xff, 0xff, 0xff, 0xff, 0xff, 0xff, 0xff, 0xff, 0xff, 0xff, 0xff, 0xff, 0xff, 0x5f, 0xe7, 0x5a, 0x2c, 0x1a, 0x04, 0x5a, 0x34, 0x3a, 0x24, 0x3a, 0x24, 0x3a, 0x24, 0x3a, 0x24, 0x5a, 0x34, 0xb9, 0x03, 0x7d, 0xbe, 0xff, 0xff, 0xbf, 0xff, 0xdf, 0xff, 0xdf, 0xff, 
  0xdf, 0xff, 0xdf, 0xff, 0xdf, 0xff, 0xff, 0xff, 0x5b, 0x8d, 0xd9, 0x03, 0x5a, 0x34, 0x3a, 0x24, 0x3a, 0x24, 0x3a, 0x24, 0x5a, 0x3c, 0xd9, 0x03, 0x1b, 0x75, 0xdf, 0xff, 0xff, 0xff, 0xff, 0xff, 0x1e, 0xdf, 0xbf, 0xf7, 0xff, 0xff, 0x5e, 0xe7, 0x7e, 0xef, 0xff, 0xff, 0xff, 0xff, 0x5f, 0xe7, 0x5a, 0x2c, 0x1a, 0x04, 0x5a, 0x34, 0x3a, 0x24, 0x3a, 0x24, 0x3a, 0x24, 0x5a, 0x34, 0xb9, 0x03, 0x7d, 0xbe, 0xff, 0xff, 0xbf, 0xff, 0xdf, 0xff, 0xdf, 0xff, 
  0xdf, 0xff, 0xdf, 0xff, 0xdf, 0xff, 0xff, 0xff, 0x7b, 0x8d, 0xd9, 0x03, 0x5a, 0x34, 0x3a, 0x24, 0x3a, 0x24, 0x5a, 0x34, 0xd9, 0x03, 0xfb, 0x6c, 0xdf, 0xf7, 0xff, 0xff, 0xff, 0xff, 0xfd, 0xd6, 0xf8, 0x3b, 0x9f, 0xf7, 0xff, 0xff, 0xdd, 0xd6, 0x18, 0x5c, 0xbf, 0xf7, 0xff, 0xff, 0xff, 0xff, 0x5e, 0xe7, 0x3a, 0x24, 0x1a, 0x04, 0x5a, 0x2c, 0x3a, 0x24, 0x3a, 0x24, 0x5a, 0x34, 0xb9, 0x03, 0x7d, 0xbe, 0xff, 0xff, 0xbf, 0xff, 0xdf, 0xff, 0xdf, 0xff, 
  0xdf, 0xff, 0xdf, 0xff, 0xdf, 0xff, 0xff, 0xff, 0x5b, 0x8d, 0xd9, 0x03, 0x5a, 0x34, 0x3a, 0x24, 0x5a, 0x2c, 0x1a, 0x04, 0xfb, 0x6c, 0xbf, 0xf7, 0xff, 0xff, 0xff, 0xff, 0x1d, 0xdf, 0x77, 0x03, 0x79, 0x4c, 0xbf, 0xf7, 0xff, 0xff, 0x3e, 0xdf, 0x58, 0x03, 0x78, 0x64, 0xbf, 0xf7, 0xff, 0xff, 0xff, 0xff, 0x3e, 0xdf, 0x5a, 0x2c, 0x3a, 0x24, 0x3a, 0x2c, 0x3a, 0x24, 0x5a, 0x34, 0xb9, 0x03, 0x7d, 0xc6, 0xff, 0xff, 0xbf, 0xff, 0xdf, 0xff, 0xdf, 0xff, 
  0xdf, 0xff, 0xdf, 0xff, 0xdf, 0xff, 0xff, 0xff, 0x7b, 0x8d, 0xd9, 0x03, 0x5a, 0x34, 0x3a, 0x24, 0x5a, 0x3c, 0xb9, 0x03, 0x1e, 0xd7, 0xff, 0xff, 0xff, 0xff, 0x1e, 0xdf, 0x97, 0x03, 0xf9, 0x03, 0xba, 0x54, 0xbf, 0xf7, 0xff, 0xff, 0x1e, 0xdf, 0x3a, 0x1c, 0x78, 0x03, 0xd9, 0x7c, 0xff, 0xff, 0xff, 0xff, 0xff, 0xff, 0xdc, 0x9d, 0xb9, 0x03, 0x5a, 0x34, 0x3a, 0x24, 0x5a, 0x34, 0xb9, 0x03, 0x7d, 0xc6, 0xff, 0xff, 0xbf, 0xff, 0xdf, 0xff, 0xdf, 0xff, 
  0xdf, 0xff, 0xdf, 0xff, 0xdf, 0xff, 0xff, 0xff, 0x9b, 0x95, 0xd9, 0x03, 0x5a, 0x34, 0x3a, 0x24, 0x5a, 0x34, 0xf9, 0x03, 0xbb, 0x9d, 0xbf, 0xf7, 0xdd, 0xd6, 0xb7, 0x0b, 0x19, 0x14, 0x3a, 0x1c, 0x9a, 0x4c, 0xbf, 0xf7, 0xff, 0xff, 0x3e, 0xdf, 0xd9, 0x03, 0x5a, 0x34, 0x1e, 0xdf, 0xff, 0xff, 0xff, 0xff, 0x9f, 0xf7, 0x9a, 0x5c, 0x1a, 0x04, 0x3a, 0x2c, 0x3a, 0x24, 0x5a, 0x34, 0xb9, 0x03, 0x9d, 0xc6, 0xff, 0xff, 0xbf, 0xff, 0xdf, 0xff, 0xdf, 0xff, 
  0xdf, 0xff, 0xdf, 0xff, 0xbf, 0xff, 0xff, 0xff, 0xdc, 0x9d, 0xd9, 0x03, 0x5a, 0x34, 0x3a, 0x24, 0x3a, 0x24, 0x5a, 0x2c, 0xb8, 0x03, 0xf7, 0x4b, 0x97, 0x03, 0xf9, 0x0b, 0x5a, 0x34, 0x1a, 0x04, 0x9a, 0x4c, 0xbf, 0xf7, 0xff, 0xff, 0x1e, 0xd7, 0xd9, 0x03, 0x3e, 0xdf, 0xff, 0xff, 0xff, 0xff, 0xbf, 0xf7, 0x78, 0x6c, 0xb9, 0x03, 0x5a, 0x34, 0x3a, 0x24, 0x3a, 0x24, 0x5a, 0x34, 0xd9, 0x03, 0xdd, 0xd6, 0xff, 0xff, 0xbf, 0xff, 0xdf, 0xff, 0xdf, 0xff, 
  0xdf, 0xff, 0xdf, 0xff, 0xbf, 0xff, 0xff, 0xff, 0x7d, 0xbe, 0xb9, 0x03, 0x5a, 0x34, 0x3a, 0x24, 0x3a, 0x24, 0x3a, 0x24, 0x3a, 0x2c, 0xf8, 0x13, 0x39, 0x2c, 0x5a, 0x2c, 0x3a, 0x2c, 0x1a, 0x04, 0x9a, 0x4c, 0xbf, 0xf7, 0xff, 0xff, 0x3e, 0xdf, 0x1e, 0xd7, 0xff, 0xff, 0xff, 0xff, 0xbf, 0xf7, 0x78, 0x6c, 0x98, 0x03, 0x5a, 0x34, 0x3a, 0x24, 0x3a, 0x24, 0x3a, 0x24, 0x3a, 0x24, 0x1a, 0x04, 0x3e, 0xe7, 0xff, 0xff, 0xdf, 0xff, 0xdf, 0xff, 0xdf, 0xff, 
  0xdf, 0xff, 0xdf, 0xff, 0xdf, 0xff, 0xff, 0xff, 0x1e, 0xdf, 0xfa, 0x03, 0x3a, 0x2c, 0x3a, 0x24, 0x3a, 0x24, 0x3a, 0x24, 0x3a, 0x24, 0x5a, 0x2c, 0x3a, 0x24, 0x3a, 0x24, 0x3a, 0x2c, 0x1a, 0x04, 0x9a, 0x4c, 0xbf, 0xf7, 0xff, 0xff, 0xff, 0xff, 0xff, 0xff, 0xff, 0xff, 0xbf, 0xf7, 0x98, 0x6c, 0x98, 0x03, 0x7a, 0x3c, 0x3a, 0x24, 0x3a, 0x24, 0x3a, 0x24, 0x3a, 0x2c, 0x1a, 0x04, 0xda, 0x5c, 0xbf, 0xf7, 0xdf, 0xff, 0xdf, 0xff, 0xdf, 0xff, 0xdf, 0xff, 
  0xdf, 0xff, 0xdf, 0xff, 0xdf, 0xff, 0xdf, 0xff, 0xbf, 0xff, 0xda, 0x64, 0x1a, 0x04, 0x5a, 0x2c, 0x3a, 0x24, 0x3a, 0x24, 0x3a, 0x24, 0x3a, 0x24, 0x3a, 0x24, 0x3a, 0x24, 0x3a, 0x2c, 0x1a, 0x04, 0x9a, 0x4c, 0xbf, 0xf7, 0xff, 0xff, 0xff, 0xff, 0xff, 0xff, 0xbf, 0xf7, 0x98, 0x6c, 0x98, 0x03, 0x5a, 0x34, 0x3a, 0x24, 0x3a, 0x24, 0x3a, 0x24, 0x3a, 0x24, 0x5a, 0x34, 0xb9, 0x03, 0xfc, 0xa5, 0xff, 0xff, 0xbf, 0xff, 0xdf, 0xff, 0xdf, 0xff, 0xdf, 0xff, 
  0xdf, 0xff, 0xdf, 0xff, 0xdf, 0xff, 0xbf, 0xff, 0xff, 0xff, 0x5c, 0xbe, 0xb9, 0x03, 0x5a, 0x3c, 0x3a, 0x24, 0x3a, 0x24, 0x3a, 0x24, 0x3a, 0x24, 0x3a, 0x24, 0x3a, 0x24, 0x3a, 0x2c, 0x1a, 0x04, 0x9a, 0x54, 0xbf, 0xf7, 0xff, 0xff, 0xff, 0xff, 0xbf, 0xf7, 0xb8, 0x74, 0x98, 0x03, 0x7a, 0x3c, 0x3a, 0x24, 0x3a, 0x24, 0x3a, 0x24, 0x3a, 0x24, 0x3a, 0x24, 0x3a, 0x2c, 0x1a, 0x04, 0x3e, 0xe7, 0xff, 0xff, 0xdf, 0xff, 0xdf, 0xff, 0xdf, 0xff, 0xdf, 0xff, 
  0xdf, 0xff, 0xdf, 0xff, 0xdf, 0xff, 0xdf, 0xff, 0xdf, 0xff, 0xbf, 0xf7, 0x9a, 0x54, 0x1a, 0x04, 0x5a, 0x2c, 0x3a, 0x24, 0x3a, 0x24, 0x3a, 0x24, 0x3a, 0x24, 0x3a, 0x24, 0x3a, 0x2c, 0x3a, 0x1c, 0x7a, 0x3c, 0xbf, 0xf7, 0xff, 0xff, 0xbf, 0xf7, 0xb9, 0x74, 0x78, 0x03, 0x7a, 0x3c, 0x3a, 0x24, 0x3a, 0x24, 0x3a, 0x24, 0x3a, 0x24, 0x3a, 0x24, 0x5a, 0x3c, 0xb9, 0x03, 0xbc, 0x9d, 0xff, 0xff, 0xdf, 0xff, 0xdf, 0xff, 0xdf, 0xff, 0xdf, 0xff, 0xdf, 0xff, 
  0xdf, 0xff, 0xdf, 0xff, 0xdf, 0xff, 0xdf, 0xff, 0xbf, 0xff, 0xff, 0xff, 0xdd, 0xd6, 0xb9, 0x03, 0x5a, 0x34, 0x3a, 0x24, 0x3a, 0x24, 0x3a, 0x24, 0x3a, 0x24, 0x3a, 0x24, 0x3a, 0x24, 0x5a, 0x2c, 0xf9, 0x03, 0x9a, 0x95, 0xfd, 0xd6, 0xb9, 0x74, 0x78, 0x03, 0x5a, 0x3c, 0x3a, 0x24, 0x3a, 0x24, 0x3a, 0x24, 0x3a, 0x24, 0x3a, 0x24, 0x5a, 0x34, 0x1a, 0x04, 0x7a, 0x44, 0x9f, 0xef, 0xdf, 0xff, 0xdf, 0xff, 0xdf, 0xff, 0xdf, 0xff, 0xdf, 0xff, 0xdf, 0xff, 
  0xdf, 0xff, 0xdf, 0xff, 0xdf, 0xff, 0xdf, 0xff, 0xdf, 0xff, 0xbf, 0xff, 0xff, 0xff, 0x1c, 0xae, 0x99, 0x03, 0x5a, 0x3c, 0x3a, 0x24, 0x3a, 0x24, 0x3a, 0x24, 0x3a, 0x24, 0x3a, 0x24, 0x3a, 0x24, 0x3a, 0x2c, 0x97, 0x03, 0xf6, 0x02, 0xb8, 0x03, 0x5a, 0x34, 0x3a, 0x24, 0x3a, 0x24, 0x3a, 0x24, 0x3a, 0x24, 0x3a, 0x1c, 0x5a, 0x34, 0x3a, 0x24, 0xd9, 0x03, 0xfd, 0xd6, 0xff, 0xff, 0xbf, 0xff, 0xdf, 0xff, 0xdf, 0xff, 0xdf, 0xff, 0xdf, 0xff, 0xdf, 0xff, 
  0xdf, 0xff, 0xdf, 0xff, 0xdf, 0xff, 0xdf, 0xff, 0xdf, 0xff, 0xdf, 0xff, 0xdf, 0xff, 0xff, 0xff, 0xdc, 0xa5, 0x99, 0x03, 0x5a, 0x34, 0x5a, 0x34, 0x3a, 0x24, 0x3a, 0x24, 0x3a, 0x24, 0x3a, 0x24, 0x3a, 0x24, 0x5a, 0x34, 0x3a, 0x34, 0x5a, 0x2c, 0x3a, 0x24, 0x3a, 0x24, 0x3a, 0x24, 0x3a, 0x24, 0x3a, 0x24, 0x5a, 0x3c, 0x1a, 0x04, 0xd9, 0x03, 0xbd, 0xce, 0xff, 0xff, 0xbf, 0xff, 0xdf, 0xff, 0xdf, 0xff, 0xdf, 0xff, 0xdf, 0xff, 0xdf, 0xff, 0xdf, 0xff, 
  0xdf, 0xff, 0xdf, 0xff, 0xdf, 0xff, 0xdf, 0xff, 0xdf, 0xff, 0xdf, 0xff, 0xdf, 0xff, 0xdf, 0xff, 0xff, 0xff, 0x3c, 0xb6, 0xd9, 0x03, 0xf9, 0x03, 0x5a, 0x34, 0x5a, 0x34, 0x3a, 0x2c, 0x3a, 0x24, 0x3a, 0x24, 0x3a, 0x24, 0x3a, 0x24, 0x3a, 0x24, 0x3a, 0x24, 0x3a, 0x24, 0x3a, 0x2c, 0x5a, 0x34, 0x5a, 0x2c, 0xb9, 0x03, 0x7a, 0x44, 0xfd, 0xd6, 0xff, 0xff, 0xbf, 0xff, 0xdf, 0xff, 0xdf, 0xff, 0xdf, 0xff, 0xdf, 0xff, 0xdf, 0xff, 0xdf, 0xff, 0xdf, 0xff, 
  0xdf, 0xff, 0xdf, 0xff, 0xdf, 0xff, 0xdf, 0xff, 0xdf, 0xff, 0xdf, 0xff, 0xdf, 0xff, 0xdf, 0xff, 0xdf, 0xff, 0xff, 0xff, 0x1e, 0xdf, 0x1b, 0x75, 0xb9, 0x03, 0xd9, 0x03, 0x3a, 0x1c, 0x5a, 0x34, 0x5a, 0x34, 0x5a, 0x34, 0x5a, 0x34, 0x5a, 0x34, 0x5a, 0x34, 0x5a, 0x34, 0x1a, 0x04, 0xd9, 0x03, 0xfa, 0x03, 0xbc, 0x95, 0x9e, 0xef, 0xff, 0xff, 0xbf, 0xff, 0xdf, 0xff, 0xdf, 0xff, 0xdf, 0xff, 0xdf, 0xff, 0xdf, 0xff, 0xdf, 0xff, 0xdf, 0xff, 0xdf, 0xff, 
  0xdf, 0xff, 0xdf, 0xff, 0xdf, 0xff, 0xdf, 0xff, 0xdf, 0xff, 0xdf, 0xff, 0xdf, 0xff, 0xdf, 0xff, 0xdf, 0xff, 0xbf, 0xff, 0xff, 0xff, 0xdf, 0xff, 0xdd, 0xce, 0x7b, 0x8d, 0x5a, 0x3c, 0xd9, 0x03, 0xb9, 0x03, 0xd9, 0x03, 0xd9, 0x03, 0xb9, 0x03, 0xb9, 0x03, 0xf9, 0x03, 0x9a, 0x54, 0xdc, 0x9d, 0x3e, 0xe7, 0xff, 0xff, 0xdf, 0xff, 0xbf, 0xff, 0xdf, 0xff, 0xdf, 0xff, 0xdf, 0xff, 0xdf, 0xff, 0xdf, 0xff, 0xdf, 0xff, 0xdf, 0xff, 0xdf, 0xff, 0xdf, 0xff, 
  0xdf, 0xff, 0xdf, 0xff, 0xdf, 0xff, 0xdf, 0xff, 0xdf, 0xff, 0xdf, 0xff, 0xdf, 0xff, 0xdf, 0xff, 0xdf, 0xff, 0xdf, 0xff, 0xdf, 0xff, 0xdf, 0xff, 0xff, 0xff, 0xff, 0xff, 0x7f, 0xef, 0xfd, 0xd6, 0x7c, 0xbe, 0x1c, 0xae, 0xfc, 0xa5, 0x1c, 0xae, 0x9d, 0xc6, 0x1e, 0xdf, 0xbf, 0xf7, 0xff, 0xff, 0xff, 0xff, 0xdf, 0xff, 0xdf, 0xff, 0xdf, 0xff, 0xdf, 0xff, 0xdf, 0xff, 0xdf, 0xff, 0xdf, 0xff, 0xdf, 0xff, 0xdf, 0xff, 0xdf, 0xff, 0xdf, 0xff, 0xdf, 0xff, 
};

const lv_image_dsc_t bluetooth_img = {
  .header.cf = LV_COLOR_FORMAT_RGB565,
  .header.magic = LV_IMAGE_HEADER_MAGIC,
  .header.w = 37,
  .header.h = 42,
  .data_size = 1554 * 2,
  .data = bluetooth_img_map,
};
```

## src/lock_img.c
```c
#ifdef __has_include
    #if __has_include("lvgl.h")
        #ifndef LV_LVGL_H_INCLUDE_SIMPLE
            #define LV_LVGL_H_INCLUDE_SIMPLE
        #endif
    #endif
#endif

#if defined(LV_LVGL_H_INCLUDE_SIMPLE)
    #include "lvgl.h"
#else
    #include "lvgl/lvgl.h"
#endif


#ifndef LV_ATTRIBUTE_MEM_ALIGN
#define LV_ATTRIBUTE_MEM_ALIGN
#endif

#ifndef LV_ATTRIBUTE_IMAGE_LOCK_IMG
#define LV_ATTRIBUTE_IMAGE_LOCK_IMG
#endif

const LV_ATTRIBUTE_MEM_ALIGN LV_ATTRIBUTE_LARGE_CONST LV_ATTRIBUTE_IMAGE_LOCK_IMG uint8_t lock_img_map[] = {
  0xde, 0xff, 0xde, 0xff, 0xde, 0xff, 0xde, 0xff, 0xde, 0xff, 0xde, 0xff, 0xde, 0xff, 0xde, 0xff, 0xde, 0xff, 0xde, 0xff, 0xde, 0xff, 0xbe, 0xff, 0xdf, 0xff, 0xff, 0xff, 0xff, 0xff, 0xff, 0xff, 0xff, 0xff, 0xff, 0xff, 0xff, 0xff, 0xff, 0xff, 0xff, 0xff, 0xdf, 0xff, 0xbe, 0xff, 0xde, 0xff, 0xde, 0xff, 0xde, 0xff, 0xde, 0xff, 0xde, 0xff, 0xde, 0xff, 0xde, 0xff, 0xde, 0xff, 0xde, 0xff, 0xde, 0xff, 0xde, 0xff, 
  0xde, 0xff, 0xde, 0xff, 0xde, 0xff, 0xde, 0xff, 0xde, 0xff, 0xde, 0xff, 0xde, 0xff, 0xde, 0xff, 0xde, 0xff, 0xde, 0xff, 0xbe, 0xff, 0xff, 0xff, 0xff, 0xff, 0x3c, 0xff, 0x38, 0xf6, 0x55, 0xed, 0xd3, 0xec, 0xd3, 0xec, 0x55, 0xed, 0x38, 0xf6, 0x3c, 0xff, 0xff, 0xff, 0xff, 0xff, 0xbe, 0xff, 0xde, 0xff, 0xde, 0xff, 0xde, 0xff, 0xde, 0xff, 0xde, 0xff, 0xde, 0xff, 0xde, 0xff, 0xde, 0xff, 0xde, 0xff, 0xde, 0xff, 
  0xde, 0xff, 0xde, 0xff, 0xde, 0xff, 0xde, 0xff, 0xde, 0xff, 0xde, 0xff, 0xde, 0xff, 0xde, 0xff, 0xbe, 0xff, 0xde, 0xff, 0xff, 0xff, 0x1b, 0xff, 0xd3, 0xec, 0x49, 0xe2, 0xc0, 0xe0, 0x00, 0xe0, 0x00, 0xe0, 0x00, 0xe0, 0x40, 0xe0, 0x80, 0xe0, 0x49, 0xe2, 0xd3, 0xec, 0x3c, 0xff, 0xff, 0xff, 0xde, 0xff, 0xde, 0xff, 0xdf, 0xff, 0xde, 0xff, 0xde, 0xff, 0xde, 0xff, 0xde, 0xff, 0xde, 0xff, 0xde, 0xff, 0xde, 0xff, 
  0xde, 0xff, 0xde, 0xff, 0xde, 0xff, 0xde, 0xff, 0xde, 0xff, 0xde, 0xff, 0xde, 0xff, 0xde, 0xff, 0xdf, 0xff, 0xff, 0xff, 0x17, 0xf6, 0xe8, 0xe1, 0x00, 0xe0, 0x07, 0xe2, 0xe3, 0xe0, 0x20, 0xe0, 0x21, 0xe1, 0x00, 0xe1, 0x20, 0xe0, 0x24, 0xe1, 0x28, 0xe2, 0x00, 0xe0, 0x29, 0xe2, 0x38, 0xf6, 0xff, 0xff, 0xde, 0xff, 0xde, 0xff, 0xde, 0xff, 0xde, 0xff, 0xde, 0xff, 0xde, 0xff, 0xde, 0xff, 0xde, 0xff, 0xde, 0xff, 
  0xde, 0xff, 0xde, 0xff, 0xde, 0xff, 0xde, 0xff, 0xde, 0xff, 0xde, 0xff, 0xde, 0xff, 0xde, 0xff, 0xff, 0xff, 0x96, 0xf5, 0x00, 0xe0, 0x48, 0xe2, 0xc6, 0xe1, 0x86, 0xe1, 0x71, 0xec, 0xd6, 0xf5, 0x58, 0xf6, 0x38, 0xf6, 0xb6, 0xf5, 0x10, 0xec, 0x04, 0xe1, 0x28, 0xe2, 0x08, 0xe2, 0x00, 0xe0, 0xf7, 0xf5, 0xff, 0xff, 0xde, 0xff, 0xde, 0xff, 0xde, 0xff, 0xde, 0xff, 0xde, 0xff, 0xde, 0xff, 0xde, 0xff, 0xde, 0xff, 
  0xde, 0xff, 0xde, 0xff, 0xde, 0xff, 0xde, 0xff, 0xde, 0xff, 0xde, 0xff, 0xbe, 0xff, 0xff, 0xff, 0x18, 0xf6, 0x00, 0xe0, 0x8a, 0xea, 0x00, 0xe1, 0xcf, 0xeb, 0xfb, 0xfe, 0xde, 0xff, 0xff, 0xff, 0xff, 0xff, 0xff, 0xff, 0xff, 0xff, 0xde, 0xff, 0xba, 0xf6, 0x4c, 0xeb, 0x63, 0xe1, 0x69, 0xe2, 0x00, 0xe0, 0x79, 0xf6, 0xff, 0xff, 0xbe, 0xff, 0xde, 0xff, 0xde, 0xff, 0xde, 0xff, 0xde, 0xff, 0xde, 0xff, 0xde, 0xff, 
  0xde, 0xff, 0xde, 0xff, 0xde, 0xff, 0xde, 0xff, 0xde, 0xff, 0xbe, 0xff, 0xff, 0xff, 0x3c, 0xff, 0xe8, 0xe1, 0x48, 0xe2, 0xe0, 0xe0, 0x71, 0xec, 0xbe, 0xff, 0xff, 0xff, 0xdf, 0xff, 0xde, 0xff, 0xde, 0xff, 0xde, 0xff, 0xde, 0xff, 0xdf, 0xff, 0xff, 0xff, 0x9e, 0xff, 0xce, 0xeb, 0x84, 0xe1, 0xa6, 0xe1, 0xeb, 0xea, 0x7d, 0xff, 0xff, 0xff, 0xbe, 0xff, 0xde, 0xff, 0xde, 0xff, 0xde, 0xff, 0xde, 0xff, 0xde, 0xff, 
  0xde, 0xff, 0xde, 0xff, 0xde, 0xff, 0xde, 0xff, 0xde, 0xff, 0xde, 0xff, 0xff, 0xff, 0xf3, 0xec, 0x00, 0xe0, 0xc6, 0xe1, 0xae, 0xeb, 0xbe, 0xff, 0xff, 0xff, 0xbe, 0xff, 0xde, 0xff, 0xde, 0xff, 0xde, 0xff, 0xde, 0xff, 0xde, 0xff, 0xde, 0xff, 0xbe, 0xff, 0xff, 0xff, 0x7d, 0xff, 0xaa, 0xea, 0x48, 0xe2, 0x00, 0xe0, 0xb6, 0xf5, 0xff, 0xff, 0xde, 0xff, 0xde, 0xff, 0xde, 0xff, 0xde, 0xff, 0xde, 0xff, 0xde, 0xff, 
  0xde, 0xff, 0xde, 0xff, 0xde, 0xff, 0xde, 0xff, 0xde, 0xff, 0xff, 0xff, 0x5d, 0xff, 0x69, 0xe2, 0xe6, 0xe1, 0x23, 0xe1, 0xba, 0xf6, 0xff, 0xff, 0xbe, 0xff, 0xdf, 0xff, 0xde, 0xff, 0xde, 0xff, 0xde, 0xff, 0xde, 0xff, 0xde, 0xff, 0xde, 0xff, 0xde, 0xff, 0xbe, 0xff, 0xff, 0xff, 0x18, 0xf6, 0x20, 0xe0, 0xa6, 0xe1, 0xae, 0xeb, 0xbe, 0xff, 0xff, 0xff, 0xde, 0xff, 0xde, 0xff, 0xde, 0xff, 0xde, 0xff, 0xde, 0xff, 
  0xde, 0xff, 0xde, 0xff, 0xde, 0xff, 0xde, 0xff, 0xbe, 0xff, 0xff, 0xff, 0x79, 0xf6, 0xc0, 0xe0, 0x02, 0xe1, 0xef, 0xeb, 0xbe, 0xff, 0xdf, 0xff, 0xde, 0xff, 0xde, 0xff, 0xde, 0xff, 0xde, 0xff, 0xde, 0xff, 0xde, 0xff, 0xde, 0xff, 0xde, 0xff, 0xde, 0xff, 0xde, 0xff, 0xff, 0xff, 0x5d, 0xff, 0xeb, 0xea, 0x42, 0xe1, 0x48, 0xea, 0x1c, 0xff, 0xff, 0xff, 0xde, 0xff, 0xde, 0xff, 0xde, 0xff, 0xde, 0xff, 0xde, 0xff, 
  0xde, 0xff, 0xde, 0xff, 0xde, 0xff, 0xde, 0xff, 0xbe, 0xff, 0xff, 0xff, 0xb6, 0xf5, 0x00, 0xe0, 0x00, 0xe0, 0x55, 0xf5, 0xff, 0xff, 0xde, 0xff, 0xde, 0xff, 0xde, 0xff, 0xde, 0xff, 0xde, 0xff, 0xde, 0xff, 0xde, 0xff, 0xde, 0xff, 0xde, 0xff, 0xde, 0xff, 0xde, 0xff, 0xdf, 0xff, 0xde, 0xff, 0x51, 0xec, 0x40, 0xe0, 0x83, 0xe1, 0x9a, 0xf6, 0xff, 0xff, 0xde, 0xff, 0xde, 0xff, 0xde, 0xff, 0xde, 0xff, 0xde, 0xff, 
  0xde, 0xff, 0xde, 0xff, 0xde, 0xff, 0xde, 0xff, 0xbe, 0xff, 0xff, 0xff, 0x75, 0xf5, 0x00, 0xe0, 0x80, 0xe0, 0xd7, 0xf5, 0xff, 0xff, 0xbe, 0xff, 0xde, 0xff, 0xde, 0xff, 0xde, 0xff, 0xde, 0xff, 0xde, 0xff, 0xde, 0xff, 0xde, 0xff, 0xde, 0xff, 0xde, 0xff, 0xde, 0xff, 0xdf, 0xff, 0xdf, 0xff, 0xb2, 0xec, 0x40, 0xe0, 0xe0, 0xe0, 0x79, 0xf6, 0xff, 0xff, 0xde, 0xff, 0xde, 0xff, 0xde, 0xff, 0xde, 0xff, 0xde, 0xff, 
  0xde, 0xff, 0xde, 0xff, 0xde, 0xff, 0xde, 0xff, 0xbe, 0xff, 0xff, 0xff, 0x75, 0xf5, 0x00, 0xe0, 0x80, 0xe0, 0xd7, 0xf5, 0xff, 0xff, 0xbe, 0xff, 0xde, 0xff, 0xde, 0xff, 0xde, 0xff, 0xde, 0xff, 0xde, 0xff, 0xde, 0xff, 0xde, 0xff, 0xde, 0xff, 0xde, 0xff, 0xde, 0xff, 0xdf, 0xff, 0xdf, 0xff, 0xb2, 0xec, 0x40, 0xe0, 0x00, 0xe1, 0x79, 0xf6, 0xff, 0xff, 0xde, 0xff, 0xde, 0xff, 0xde, 0xff, 0xde, 0xff, 0xde, 0xff, 
  0xde, 0xff, 0xde, 0xff, 0xde, 0xff, 0xdf, 0xff, 0xbe, 0xff, 0xff, 0xff, 0x75, 0xf5, 0x00, 0xe0, 0xa0, 0xe0, 0xd7, 0xf5, 0xff, 0xff, 0xbe, 0xff, 0xdf, 0xff, 0xde, 0xff, 0xde, 0xff, 0xde, 0xff, 0xde, 0xff, 0xde, 0xff, 0xde, 0xff, 0xde, 0xff, 0xde, 0xff, 0xde, 0xff, 0xdf, 0xff, 0xdf, 0xff, 0xb2, 0xec, 0x40, 0xe0, 0xe0, 0xe0, 0x79, 0xf6, 0xff, 0xff, 0xde, 0xff, 0xde, 0xff, 0xde, 0xff, 0xde, 0xff, 0xde, 0xff, 
  0xde, 0xff, 0xde, 0xff, 0xde, 0xff, 0xde, 0xff, 0xbe, 0xff, 0xff, 0xff, 0x75, 0xf5, 0x00, 0xe0, 0x80, 0xe0, 0xd7, 0xf5, 0xff, 0xff, 0xbe, 0xff, 0xde, 0xff, 0xde, 0xff, 0xde, 0xff, 0xde, 0xff, 0xde, 0xff, 0xde, 0xff, 0xde, 0xff, 0xde, 0xff, 0xde, 0xff, 0xde, 0xff, 0xdf, 0xff, 0xdf, 0xff, 0xb2, 0xec, 0x40, 0xe0, 0xe0, 0xe0, 0x79, 0xf6, 0xff, 0xff, 0xde, 0xff, 0xde, 0xff, 0xde, 0xff, 0xde, 0xff, 0xde, 0xff, 
  0xde, 0xff, 0xde, 0xff, 0xde, 0xff, 0xde, 0xff, 0xbe, 0xff, 0xff, 0xff, 0x75, 0xf5, 0x00, 0xe0, 0xa0, 0xe0, 0xd7, 0xf5, 0xff, 0xff, 0xbe, 0xff, 0xde, 0xff, 0xde, 0xff, 0xde, 0xff, 0xde, 0xff, 0xde, 0xff, 0xde, 0xff, 0xde, 0xff, 0xde, 0xff, 0xde, 0xff, 0xde, 0xff, 0xdf, 0xff, 0xdf, 0xff, 0xb2, 0xec, 0x40, 0xe0, 0xe0, 0xe0, 0x79, 0xf6, 0xff, 0xff, 0xbe, 0xff, 0xde, 0xff, 0xde, 0xff, 0xde, 0xff, 0xde, 0xff, 
  0xde, 0xff, 0xde, 0xff, 0xde, 0xff, 0xde, 0xff, 0xff, 0xff, 0xff, 0xff, 0x75, 0xf5, 0x00, 0xe0, 0x20, 0xe0, 0xf7, 0xf5, 0xff, 0xff, 0xdf, 0xff, 0xff, 0xff, 0xff, 0xff, 0xff, 0xff, 0xff, 0xff, 0xff, 0xff, 0xff, 0xff, 0xff, 0xff, 0xff, 0xff, 0xff, 0xff, 0xff, 0xff, 0xff, 0xff, 0xdf, 0xff, 0xd3, 0xec, 0x00, 0xe0, 0xe0, 0xe0, 0x99, 0xf6, 0xff, 0xff, 0xff, 0xff, 0xde, 0xff, 0xde, 0xff, 0xde, 0xff, 0xde, 0xff, 
  0xde, 0xff, 0xde, 0xff, 0xde, 0xff, 0xff, 0xff, 0xdb, 0xfe, 0x75, 0xf5, 0xae, 0xeb, 0xa5, 0xe1, 0xc5, 0xe1, 0xef, 0xeb, 0x34, 0xf5, 0x14, 0xed, 0x14, 0xf5, 0x14, 0xf5, 0x14, 0xf5, 0x14, 0xf5, 0x14, 0xf5, 0x14, 0xf5, 0x14, 0xed, 0x14, 0xed, 0x14, 0xf5, 0x14, 0xed, 0x14, 0xed, 0x14, 0xed, 0x4c, 0xeb, 0xa5, 0xe1, 0xc6, 0xe1, 0x30, 0xec, 0x75, 0xf5, 0xfb, 0xfe, 0xff, 0xff, 0xde, 0xff, 0xde, 0xff, 0xde, 0xff, 
  0xde, 0xff, 0xde, 0xff, 0xff, 0xff, 0xf7, 0xf5, 0xa0, 0xe0, 0x00, 0xe0, 0x64, 0xe1, 0x28, 0xe2, 0x27, 0xe2, 0x01, 0xe1, 0x00, 0xe0, 0x00, 0xe0, 0x00, 0xe0, 0x00, 0xe0, 0x00, 0xe0, 0x00, 0xe0, 0x00, 0xe0, 0x00, 0xe0, 0x00, 0xe0, 0x00, 0xe0, 0x00, 0xe0, 0x00, 0xe0, 0x00, 0xe0, 0x00, 0xe0, 0x84, 0xe1, 0x28, 0xe2, 0x27, 0xe2, 0xe0, 0xe0, 0x00, 0xe0, 0x44, 0xe1, 0x79, 0xf6, 0xff, 0xff, 0xbe, 0xff, 0xde, 0xff, 
  0xbe, 0xff, 0xff, 0xff, 0xdb, 0xfe, 0x00, 0xe0, 0xa5, 0xe1, 0xca, 0xe2, 0x48, 0xe2, 0x07, 0xe2, 0x07, 0xe2, 0x48, 0xe2, 0xa9, 0xe2, 0x89, 0xe2, 0x89, 0xe2, 0x89, 0xe2, 0x89, 0xe2, 0x89, 0xe2, 0x89, 0xe2, 0x89, 0xe2, 0x89, 0xe2, 0x89, 0xe2, 0x89, 0xe2, 0x89, 0xe2, 0x89, 0xe2, 0x89, 0xe2, 0x48, 0xe2, 0x07, 0xe2, 0x07, 0xe2, 0x69, 0xe2, 0xca, 0xe2, 0x00, 0xe0, 0xcb, 0xea, 0x7d, 0xff, 0xff, 0xff, 0xbe, 0xff, 
  0xde, 0xff, 0xff, 0xff, 0x34, 0xf5, 0x00, 0xe0, 0xca, 0xe2, 0x07, 0xe2, 0x07, 0xe2, 0x07, 0xe2, 0x07, 0xe2, 0x07, 0xe2, 0x07, 0xe2, 0x28, 0xe2, 0x28, 0xe2, 0x07, 0xe2, 0x07, 0xe2, 0x07, 0xe2, 0x07, 0xe2, 0x07, 0xe2, 0x07, 0xe2, 0x07, 0xe2, 0x07, 0xe2, 0x27, 0xe2, 0x28, 0xe2, 0x07, 0xe2, 0x07, 0xe2, 0x07, 0xe2, 0x07, 0xe2, 0x07, 0xe2, 0x28, 0xe2, 0x68, 0xe2, 0xe2, 0xe0, 0x99, 0xf6, 0xff, 0xff, 0xbe, 0xff, 
  0xdf, 0xff, 0xdf, 0xff, 0xb2, 0xec, 0x00, 0xe0, 0x89, 0xe2, 0x07, 0xe2, 0x07, 0xe2, 0x07, 0xe2, 0x07, 0xe2, 0x07, 0xe2, 0x27, 0xe2, 0xa0, 0xe0, 0x40, 0xe0, 0x48, 0xe2, 0x28, 0xe2, 0x07, 0xe2, 0x07, 0xe2, 0x07, 0xe2, 0x07, 0xe2, 0x48, 0xe2, 0x07, 0xe2, 0x00, 0xe0, 0x40, 0xe0, 0x27, 0xe2, 0x07, 0xe2, 0x07, 0xe2, 0x07, 0xe2, 0x07, 0xe2, 0x28, 0xe2, 0x27, 0xe2, 0xa0, 0xe0, 0x79, 0xf6, 0xff, 0xff, 0xbe, 0xff, 
  0xdf, 0xff, 0xdf, 0xff, 0xd3, 0xec, 0x00, 0xe0, 0x89, 0xe2, 0x07, 0xe2, 0x07, 0xe2, 0x07, 0xe2, 0x27, 0xe2, 0x27, 0xe2, 0xc0, 0xe0, 0x0f, 0xec, 0x10, 0xec, 0x00, 0xe0, 0x48, 0xe2, 0x47, 0xe2, 0x07, 0xe2, 0xe6, 0xe1, 0x69, 0xe2, 0xc6, 0xe1, 0x42, 0xe1, 0x34, 0xf5, 0x92, 0xec, 0xa0, 0xe0, 0x27, 0xe2, 0x07, 0xe2, 0x07, 0xe2, 0x07, 0xe2, 0x28, 0xe2, 0x27, 0xe2, 0x80, 0xe0, 0x79, 0xf6, 0xff, 0xff, 0xbe, 0xff, 
  0xdf, 0xff, 0xdf, 0xff, 0xd2, 0xec, 0x00, 0xe0, 0x89, 0xe2, 0x07, 0xe2, 0x07, 0xe2, 0x07, 0xe2, 0x69, 0xe2, 0x00, 0xe0, 0xb2, 0xec, 0xbf, 0xff, 0xff, 0xff, 0x34, 0xf5, 0x00, 0xe0, 0x69, 0xe2, 0x07, 0xe2, 0x68, 0xe2, 0x27, 0xe2, 0x00, 0xe0, 0x18, 0xf6, 0xff, 0xff, 0xdf, 0xff, 0x92, 0xec, 0x00, 0xe0, 0x69, 0xea, 0xe6, 0xe1, 0x07, 0xe2, 0x28, 0xe2, 0x27, 0xe2, 0x60, 0xe0, 0x79, 0xf6, 0xff, 0xff, 0xbe, 0xff, 
  0xdf, 0xff, 0xdf, 0xff, 0xd2, 0xec, 0x00, 0xe0, 0x89, 0xe2, 0x07, 0xe2, 0x07, 0xe2, 0x07, 0xe2, 0x69, 0xe2, 0x00, 0xe0, 0x18, 0xf6, 0xff, 0xff, 0xdf, 0xff, 0xff, 0xff, 0x34, 0xf5, 0x00, 0xe0, 0xaa, 0xea, 0x27, 0xe2, 0x00, 0xe0, 0x38, 0xf6, 0xff, 0xff, 0xdf, 0xff, 0xff, 0xff, 0x55, 0xf5, 0x00, 0xe0, 0x89, 0xea, 0xe6, 0xe1, 0x07, 0xe2, 0x28, 0xe2, 0x27, 0xe2, 0x60, 0xe0, 0x59, 0xf6, 0xff, 0xff, 0xbe, 0xff, 
  0xdf, 0xff, 0xdf, 0xff, 0xd2, 0xec, 0x00, 0xe0, 0x89, 0xe2, 0x07, 0xe2, 0x07, 0xe2, 0x07, 0xe2, 0x48, 0xe2, 0xc5, 0xe1, 0xca, 0xea, 0x1c, 0xff, 0xff, 0xff, 0xdf, 0xff, 0xff, 0xff, 0x55, 0xf5, 0x00, 0xe0, 0xe0, 0xe0, 0x59, 0xf6, 0xff, 0xff, 0xde, 0xff, 0xff, 0xff, 0x59, 0xf6, 0x44, 0xe1, 0x27, 0xe2, 0x07, 0xe2, 0x07, 0xe2, 0x07, 0xe2, 0x28, 0xe2, 0x27, 0xe2, 0x60, 0xe0, 0x79, 0xf6, 0xff, 0xff, 0xbe, 0xff, 
  0xdf, 0xff, 0xdf, 0xff, 0xd2, 0xec, 0x00, 0xe0, 0x89, 0xe2, 0x07, 0xe2, 0x07, 0xe2, 0x07, 0xe2, 0x07, 0xe2, 0x48, 0xe2, 0xc0, 0xe0, 0xa9, 0xea, 0x1c, 0xff, 0xff, 0xff, 0xdf, 0xff, 0xff, 0xff, 0x34, 0xf5, 0x18, 0xf6, 0xff, 0xff, 0xdf, 0xff, 0xff, 0xff, 0x79, 0xfe, 0x63, 0xe0, 0xa5, 0xe1, 0x28, 0xe2, 0x07, 0xe2, 0x07, 0xe2, 0x07, 0xe2, 0x28, 0xe2, 0x27, 0xe2, 0x60, 0xe0, 0x59, 0xf6, 0xff, 0xff, 0xbe, 0xff, 
  0xdf, 0xff, 0xdf, 0xff, 0xd2, 0xec, 0x00, 0xe0, 0x89, 0xe2, 0x07, 0xe2, 0x07, 0xe2, 0x07, 0xe2, 0x07, 0xe2, 0x07, 0xe2, 0x89, 0xe2, 0xe0, 0xe0, 0x89, 0xea, 0x1c, 0xff, 0xff, 0xff, 0xdf, 0xff, 0xff, 0xff, 0xff, 0xff, 0xdf, 0xff, 0xff, 0xff, 0x79, 0xf6, 0x01, 0xe0, 0xc6, 0xe1, 0x68, 0xe2, 0x07, 0xe2, 0x07, 0xe2, 0x07, 0xe2, 0x07, 0xe2, 0x28, 0xe2, 0x27, 0xe2, 0x60, 0xe0, 0x79, 0xf6, 0xff, 0xff, 0xbe, 0xff, 
  0xdf, 0xff, 0xdf, 0xff, 0xd2, 0xec, 0x00, 0xe0, 0x89, 0xe2, 0x07, 0xe2, 0x07, 0xe2, 0x07, 0xe2, 0x07, 0xe2, 0x07, 0xe2, 0x07, 0xe2, 0x69, 0xe2, 0x43, 0xe1, 0x69, 0xea, 0xfb, 0xfe, 0xff, 0xff, 0xdf, 0xff, 0xdf, 0xff, 0xff, 0xff, 0x38, 0xf6, 0x04, 0xe1, 0xc6, 0xe1, 0x48, 0xe2, 0x07, 0xe2, 0x07, 0xe2, 0x07, 0xe2, 0x07, 0xe2, 0x07, 0xe2, 0x28, 0xe2, 0x27, 0xe2, 0x60, 0xe0, 0x59, 0xf6, 0xff, 0xff, 0xbe, 0xff, 
  0xdf, 0xff, 0xdf, 0xff, 0xd2, 0xec, 0x00, 0xe0, 0x89, 0xe2, 0x07, 0xe2, 0x07, 0xe2, 0x07, 0xe2, 0x07, 0xe2, 0x27, 0xe2, 0xe6, 0xe1, 0x68, 0xe2, 0x07, 0xe2, 0x00, 0xe0, 0x79, 0xfe, 0xff, 0xff, 0xde, 0xff, 0xdf, 0xff, 0xff, 0xff, 0x14, 0xed, 0x00, 0xe0, 0x89, 0xea, 0x27, 0xe2, 0x07, 0xe2, 0x07, 0xe2, 0x07, 0xe2, 0x07, 0xe2, 0x07, 0xe2, 0x28, 0xe2, 0x27, 0xe2, 0x60, 0xe0, 0x59, 0xf6, 0xff, 0xff, 0xbe, 0xff, 
  0xdf, 0xff, 0xdf, 0xff, 0xd2, 0xec, 0x00, 0xe0, 0x89, 0xe2, 0x07, 0xe2, 0x07, 0xe2, 0x07, 0xe2, 0x07, 0xe2, 0xe6, 0xe1, 0x69, 0xe2, 0xc5, 0xe1, 0x00, 0xe1, 0x9a, 0xfe, 0xff, 0xff, 0xdf, 0xff, 0xff, 0xff, 0xff, 0xff, 0xff, 0xff, 0xff, 0xff, 0x14, 0xf5, 0x00, 0xe0, 0x69, 0xe2, 0x27, 0xe2, 0x07, 0xe2, 0x07, 0xe2, 0x07, 0xe2, 0x07, 0xe2, 0x28, 0xe2, 0x27, 0xe2, 0x60, 0xe0, 0x79, 0xf6, 0xff, 0xff, 0xbe, 0xff, 
  0xdf, 0xff, 0xdf, 0xff, 0xd2, 0xec, 0x00, 0xe0, 0x89, 0xe2, 0x07, 0xe2, 0x07, 0xe2, 0x07, 0xe2, 0x07, 0xe2, 0x48, 0xe2, 0xa5, 0xe1, 0x42, 0xe1, 0x9a, 0xfe, 0xff, 0xff, 0xdf, 0xff, 0xff, 0xff, 0x59, 0xf6, 0xfb, 0xfe, 0xff, 0xff, 0xdf, 0xff, 0xff, 0xff, 0x13, 0xed, 0x00, 0xe0, 0x48, 0xe2, 0x07, 0xe2, 0x07, 0xe2, 0x07, 0xe2, 0x07, 0xe2, 0x28, 0xe2, 0x27, 0xe2, 0x80, 0xe0, 0x59, 0xf6, 0xff, 0xff, 0xbe, 0xff, 
  0xdf, 0xff, 0xdf, 0xff, 0xd2, 0xec, 0x00, 0xe0, 0x89, 0xe2, 0x07, 0xe2, 0x07, 0xe2, 0x07, 0xe2, 0x28, 0xe2, 0x07, 0xe2, 0x63, 0xe1, 0x99, 0xf6, 0xff, 0xff, 0xdf, 0xff, 0xff, 0xff, 0x59, 0xf6, 0x00, 0xe0, 0xeb, 0xea, 0x3c, 0xff, 0xff, 0xff, 0xdf, 0xff, 0xff, 0xff, 0xf3, 0xf4, 0x00, 0xe0, 0x68, 0xe2, 0x07, 0xe2, 0x07, 0xe2, 0x07, 0xe2, 0x28, 0xe2, 0x27, 0xe2, 0x60, 0xe0, 0x59, 0xf6, 0xff, 0xff, 0xbe, 0xff, 
  0xdf, 0xff, 0xdf, 0xff, 0xd2, 0xec, 0x00, 0xe0, 0x89, 0xe2, 0x07, 0xe2, 0x07, 0xe2, 0x27, 0xe2, 0x68, 0xe2, 0x00, 0xe0, 0x17, 0xf6, 0xff, 0xff, 0xde, 0xff, 0xff, 0xff, 0x38, 0xf6, 0x00, 0xe0, 0x69, 0xe2, 0x21, 0xe1, 0xea, 0xea, 0x3d, 0xff, 0xff, 0xff, 0xdf, 0xff, 0xdf, 0xff, 0x51, 0xec, 0x40, 0xe0, 0x89, 0xe2, 0xe6, 0xe1, 0x07, 0xe2, 0x28, 0xe2, 0x27, 0xe2, 0x60, 0xe0, 0x79, 0xf6, 0xff, 0xff, 0xbe, 0xff, 
  0xdf, 0xff, 0xdf, 0xff, 0xd3, 0xec, 0x00, 0xe0, 0x89, 0xe2, 0x07, 0xe2, 0x07, 0xe2, 0x27, 0xe2, 0x48, 0xe2, 0x00, 0xe0, 0x59, 0xf6, 0xff, 0xff, 0xff, 0xff, 0x18, 0xf6, 0x00, 0xe0, 0x07, 0xe2, 0x48, 0xe2, 0x89, 0xe2, 0xa0, 0xe0, 0xeb, 0xea, 0x3c, 0xff, 0xff, 0xff, 0xff, 0xff, 0xd3, 0xec, 0x00, 0xe0, 0x89, 0xea, 0xe6, 0xe1, 0x07, 0xe2, 0x28, 0xe2, 0x27, 0xe2, 0x80, 0xe0, 0x79, 0xf6, 0xff, 0xff, 0xbe, 0xff, 
  0xdf, 0xff, 0xdf, 0xff, 0xd2, 0xec, 0x00, 0xe0, 0x89, 0xe2, 0x07, 0xe2, 0x07, 0xe2, 0x07, 0xe2, 0x48, 0xe2, 0x85, 0xe1, 0xaa, 0xea, 0x38, 0xf6, 0xb6, 0xf5, 0x20, 0xe0, 0xe7, 0xe1, 0x68, 0xe2, 0x07, 0xe2, 0x07, 0xe2, 0x89, 0xe2, 0x00, 0xe0, 0x2c, 0xeb, 0x59, 0xf6, 0x75, 0xf5, 0x43, 0xe1, 0x27, 0xe2, 0x07, 0xe2, 0x07, 0xe2, 0x07, 0xe2, 0x28, 0xe2, 0x27, 0xe2, 0x80, 0xe0, 0x79, 0xf6, 0xff, 0xff, 0xbe, 0xff, 
  0xdf, 0xff, 0xdf, 0xff, 0xd2, 0xec, 0x00, 0xe0, 0x89, 0xe2, 0x07, 0xe2, 0x07, 0xe2, 0x07, 0xe2, 0x07, 0xe2, 0x27, 0xe2, 0x84, 0xe1, 0x00, 0xe0, 0x00, 0xe0, 0x07, 0xe2, 0x48, 0xe2, 0xe6, 0xe1, 0x07, 0xe2, 0x07, 0xe2, 0xe7, 0xe1, 0x68, 0xe2, 0x64, 0xe1, 0x00, 0xe0, 0x00, 0xe0, 0xe6, 0xe1, 0x07, 0xe2, 0x07, 0xe2, 0x07, 0xe2, 0x07, 0xe2, 0x28, 0xe2, 0x27, 0xe2, 0xe0, 0xe0, 0x79, 0xf6, 0xff, 0xff, 0xbe, 0xff, 
  0xde, 0xff, 0xff, 0xff, 0xd6, 0xf5, 0x00, 0xe0, 0xca, 0xe2, 0x68, 0xe2, 0x48, 0xe2, 0x48, 0xe2, 0x48, 0xe2, 0x48, 0xe2, 0x69, 0xe2, 0x68, 0xe2, 0x69, 0xe2, 0x68, 0xe2, 0x48, 0xe2, 0x48, 0xe2, 0x48, 0xe2, 0x48, 0xe2, 0x48, 0xe2, 0x48, 0xe2, 0x69, 0xe2, 0x68, 0xe2, 0x69, 0xe2, 0x68, 0xe2, 0x48, 0xe2, 0x48, 0xe2, 0x48, 0xe2, 0x48, 0xe2, 0xa9, 0xea, 0xc6, 0xe1, 0x28, 0xe2, 0x3c, 0xff, 0xff, 0xff, 0xbe, 0xff, 
  0xbe, 0xff, 0xff, 0xff, 0x7d, 0xff, 0x6e, 0xeb, 0x00, 0xe0, 0x28, 0xe2, 0x07, 0xe2, 0x07, 0xe2, 0x07, 0xe2, 0x07, 0xe2, 0x07, 0xe2, 0x08, 0xe2, 0x08, 0xe2, 0x07, 0xe2, 0x07, 0xe2, 0x07, 0xe2, 0x07, 0xe2, 0x07, 0xe2, 0x07, 0xe2, 0x07, 0xe2, 0x07, 0xe2, 0x08, 0xea, 0x07, 0xe2, 0x07, 0xe2, 0x07, 0xe2, 0x07, 0xe2, 0x07, 0xe2, 0x28, 0xe2, 0xa6, 0xe1, 0x00, 0xe0, 0x55, 0xf5, 0xff, 0xff, 0xde, 0xff, 0xde, 0xff, 
  0xde, 0xff, 0xbe, 0xff, 0xff, 0xff, 0x3c, 0xff, 0x30, 0xec, 0xc7, 0xe1, 0x86, 0xe1, 0x86, 0xe1, 0x86, 0xe1, 0x86, 0xe1, 0x86, 0xe1, 0x86, 0xe1, 0x86, 0xe1, 0x86, 0xe1, 0x86, 0xe1, 0x86, 0xe1, 0x86, 0xe1, 0x86, 0xe1, 0x86, 0xe1, 0x86, 0xe1, 0x86, 0xe1, 0x86, 0xe1, 0x86, 0xe1, 0x86, 0xe1, 0x86, 0xe1, 0x86, 0xe1, 0x86, 0xe1, 0x86, 0xe1, 0xab, 0xea, 0x95, 0xf5, 0xbe, 0xff, 0xdf, 0xff, 0xbe, 0xff, 0xde, 0xff, 
  0xde, 0xff, 0xde, 0xff, 0xbe, 0xff, 0xff, 0xff, 0xde, 0xff, 0xfb, 0xfe, 0xda, 0xfe, 0xdb, 0xfe, 0xdb, 0xfe, 0xdb, 0xfe, 0xdb, 0xfe, 0xdb, 0xfe, 0xdb, 0xfe, 0xdb, 0xfe, 0xdb, 0xfe, 0xdb, 0xfe, 0xdb, 0xfe, 0xdb, 0xfe, 0xdb, 0xfe, 0xdb, 0xfe, 0xdb, 0xfe, 0xdb, 0xfe, 0xdb, 0xfe, 0xdb, 0xfe, 0xdb, 0xfe, 0xdb, 0xfe, 0xdb, 0xfe, 0xdb, 0xfe, 0x5d, 0xff, 0xff, 0xff, 0xdf, 0xff, 0xde, 0xff, 0xde, 0xff, 0xde, 0xff, 
  0xde, 0xff, 0xde, 0xff, 0xde, 0xff, 0xbe, 0xff, 0xdf, 0xff, 0xff, 0xff, 0xff, 0xff, 0xff, 0xff, 0xff, 0xff, 0xff, 0xff, 0xff, 0xff, 0xff, 0xff, 0xff, 0xff, 0xff, 0xff, 0xff, 0xff, 0xff, 0xff, 0xff, 0xff, 0xff, 0xff, 0xff, 0xff, 0xff, 0xff, 0xff, 0xff, 0xff, 0xff, 0xff, 0xff, 0xff, 0xff, 0xff, 0xff, 0xff, 0xff, 0xff, 0xff, 0xff, 0xff, 0xff, 0xff, 0xde, 0xff, 0xbe, 0xff, 0xde, 0xff, 0xde, 0xff, 0xde, 0xff, 
  0xde, 0xff, 0xde, 0xff, 0xde, 0xff, 0xde, 0xff, 0xbe, 0xff, 0xbe, 0xff, 0xbe, 0xff, 0xbe, 0xff, 0xbe, 0xff, 0xbe, 0xff, 0xbe, 0xff, 0xbe, 0xff, 0xbe, 0xff, 0xbe, 0xff, 0xbe, 0xff, 0xbe, 0xff, 0xbe, 0xff, 0xbe, 0xff, 0xbe, 0xff, 0xbe, 0xff, 0xbe, 0xff, 0xbe, 0xff, 0xbe, 0xff, 0xbe, 0xff, 0xbe, 0xff, 0xbe, 0xff, 0xbe, 0xff, 0xbe, 0xff, 0xbe, 0xff, 0xde, 0xff, 0xde, 0xff, 0xde, 0xff, 0xde, 0xff, 0xde, 0xff, 
};

const lv_image_dsc_t lock_img = {
  .header.cf = LV_COLOR_FORMAT_RGB565,
  .header.magic = LV_IMAGE_HEADER_MAGIC,
  .header.w = 34,
  .header.h = 43,
  .data_size = 1462 * 2,
  .data = lock_img_map,
};
```
